// =====================================================================
//  Göz Anahtarlık - Aşama 1 yazılımı
//  ESP32-C3 Super Mini + ST7789 240x240 (CS yok) + LiPo/TP4056
//
//  Arduino IDE ayarları:
//    Kart: "ESP32C3 Dev Module"   USB CDC On Boot: Enabled
//  Gerekli kütüphaneler (Kütüphane Yöneticisi):
//    - LovyanGFX            (lovyan03)
//    - NimBLE-Arduino       (h2zero)  -> 2.x sürümü
//
//  Telefonsuz test:
//    BOOT tuşu: kısa bas = sonraki mod, uzun bas (1,2 sn) = ekranı döndür
//               ekran kararmışken / gece uykusundayken ilk basış sadece uyandırır
//    Seri Port Ekranı (115200):
//      0-7 mod | r döndür | e duygu | t yazı | n bildirim | p müzik çalıyor/durdu | b ritim
//      l parlaklık | d kararma testi | g gece uykusu testi
// =====================================================================

#define LGFX_USE_V1
#include <LovyanGFX.hpp>
#include <NimBLEDevice.h>
#include <Preferences.h>
#include <esp_sleep.h>
#include <esp_heap_caps.h>
#include <esp_arduino_version.h>
#include <driver/gpio.h>
#include <Update.h>

#define FW_VERSION 15              // uygulamada görünen anahtarlık yazılımı sürümü

// ---------------- TÜRLER (fonksiyonlardan önce olmalı) ----------------
// Kritik sönümlü yay: hedefe yaylanarak, kare hızından bağımsız gider
struct Spring {
  float x = 0, v = 0, t = 0;
  void step(float dt, float k) {
    float c = 2.0f * sqrtf(k);
    v += (k * (t - x) - c * v) * dt;
    x += v * dt;
  }
  bool moving() const { return fabsf(v) > 0.02f || fabsf(t - x) > 0.01f; }
};

// Göz şekli parametreleri
enum { S_W, S_H, S_R, S_GAP, S_TIRED, S_ANGRY, S_SAD, S_HAPPY, S_BOTTOM, S_SIZE_L, S_SIZE_R, S_LOOKY, S_COUNT };

struct ModePreset {
  const char *name;
  uint8_t r, g, b;
  float shape[S_COUNT];
  uint16_t blinkMin, blinkMax;     // ms
  float blinkSpeed;                // 1 = normal, >1 = yavaş
  uint16_t lookMin, lookMax;       // ms
  float lookRange;
  float bobAmp;                    // px
  uint8_t idleW[7];                // boş davranış ağırlıkları
};

// Boş davranışlar (kişilik)
enum Idle { I_NONE, I_CURIOUS, I_SLEEPY, I_HAPPY, I_SURPRISE, I_WINK, I_LOOKAROUND,
            I_ROLL, I_UPDOWN, I_THINK, I_DIZZY, I_YAWN, I_SQUINT, I_LOVE, I_SHIVER, I_BOUNCE, I_COUNT };
const int IDLE_EXTRA = I_COUNT - I_LOOKAROUND - 1;     // yeni hareket sayısı (9)

// Telefondan gelen geçici duygular
enum Emotion { E_NONE, E_HAPPY, E_ANGRY, E_SAD, E_SURPRISED, E_SLEEPY, E_LOVE, E_CONFUSED, E_WINK, E_COUNT };

struct TextLine { char buf[161]; int width = 0; uint32_t until = 0; float x = 0; bool active = false; };

enum PType { P_NOTE, P_ZZZ, P_TEAR, P_HEART, P_SPARK };

struct Particle { bool on; uint8_t type; float x, y, vx, vy, life, maxLife; uint8_t r, g, b; };

struct Cmd { uint8_t len; uint8_t data[200]; };

// ---------------- AYARLAR ----------------
#define PIN_SCL   4
#define PIN_SDA   6
#define PIN_DC    7
#define PIN_RES   10
#define PIN_BAT   1
#define PIN_BOOT  9
#define PIN_BL    3           // Ekranın BLK (arka ışık) ucu bu GPIO'ya bağlı. BLK hâlâ 3V3'e bağlıysa -1 yap.
#define BL_FREQ   20000       // PWM frekansı (duyulmaz)
#define BL_BITS   10          // 0-1023: düşük parlaklıkta da yumuşak geçiş
#define BL_CH     0           // sadece eski (2.x) ESP32 çekirdeğinde kullanılır
#define SPI_HZ    80000000    // Ekranda bozulma/kar görürsen 40000000 yap
#define USE_SMOOTH 1          // Yumuşak kenarlı çizim. Derleme hatası verirse 0 yap.
#define HAS_BATTERY_DIVIDER 1

#define SERVICE_UUID "7a1e0001-5d3c-4b8e-9a53-2f6c9d1e0001"
#define CMD_UUID     "7a1e0002-5d3c-4b8e-9a53-2f6c9d1e0001"
#define STATUS_UUID  "7a1e0003-5d3c-4b8e-9a53-2f6c9d1e0001"

// ---------------- TÜRKÇE YAZI TİPİ (yumuşak kenarlı) ----------------
// Inter SemiBold 19px, Türkçe + Latin-1, 174 karakter, 29988 bayt
static const uint8_t FONT_TR[] PROGMEM = {
  0x00,0x00,0x00,0xAE,0x00,0x00,0x00,0x0B,0x00,0x00,0x00,0x13,0x00,0x00,0x00,0x00,0x00,0x00,0x00,0x13,0x00,0x00,0x00,0x05,
  0x00,0x00,0x00,0x20,0x00,0x00,0x00,0x00,0x00,0x00,0x00,0x00,0x00,0x00,0x00,0x05,0x00,0x00,0x00,0x00,0x00,0x00,0x00,0x00,
  0x00,0x00,0x00,0x00,0x00,0x00,0x00,0x21,0x00,0x00,0x00,0x0E,0x00,0x00,0x00,0x04,0x00,0x00,0x00,0x06,0x00,0x00,0x00,0x0E,
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  0x00,0x00,0x00,0x00,0x0F,0x0C,0x00,0x00,0x00,0x00,0x00,0x00,
};

// ---------------- EKRAN ----------------
class LGFX : public lgfx::LGFX_Device {
  lgfx::Panel_ST7789 _panel;
  lgfx::Bus_SPI _bus;
public:
  LGFX() {
    {
      auto cfg = _bus.config();
      cfg.spi_host = SPI2_HOST;
      cfg.spi_mode = 3;                 // CS pini olmayan ST7789 için şart
      cfg.freq_write = SPI_HZ;
      cfg.freq_read = 16000000;
      cfg.spi_3wire = false;
      cfg.use_lock = true;
      cfg.dma_channel = SPI_DMA_CH_AUTO;
      cfg.pin_sclk = PIN_SCL;
      cfg.pin_mosi = PIN_SDA;
      cfg.pin_miso = -1;
      cfg.pin_dc = PIN_DC;
      _bus.config(cfg);
      _panel.setBus(&_bus);
    }
    {
      auto cfg = _panel.config();
      cfg.pin_cs = -1;
      cfg.pin_rst = PIN_RES;
      cfg.pin_busy = -1;
      cfg.panel_width = 240;
      cfg.panel_height = 240;
      cfg.memory_width = 240;
      cfg.memory_height = 320;
      cfg.offset_x = 0;
      cfg.offset_y = 0;
      cfg.offset_rotation = 0;
      cfg.readable = false;
      cfg.invert = true;                // Renkler ters (negatif) görünürse false yap
      cfg.rgb_order = false;
      cfg.dlen_16bit = false;
      cfg.bus_shared = false;
      _panel.config(cfg);
    }
    setPanel(&_panel);                  // arka ışığı LovyanGFX değil, aşağıdaki EKRAN IŞIĞI bölümü yönetir
  }
};

LGFX lcd;
LGFX_Sprite spr(&lcd);
LGFX_Sprite sprTop(&lcd);                         // tam ekran kapağın en üst 24 satırı (durum çubuğunun yeri)
bool sprTopOk = false;
Preferences prefs;

const int STATUS_H = 24;              // üst durum çubuğu (pil, bluetooth)
const int SPR_W = 240, SPR_H = 240 - STATUS_H;
const uint16_t BG = 0x0000;

// ---------------- YARDIMCILAR ----------------
// millis() 49 günde bir başa sarar: "zamanı geldi mi" hep bu farkla sorulur (0 = hemen)
static inline bool reached(uint32_t now, uint32_t t) { return t == 0 || (int32_t)(now - t) >= 0; }
static inline float clampf(float v, float a, float b) { return v < a ? a : (v > b ? b : v); }
static inline float lerpf(float a, float b, float t) { return a + (b - a) * t; }
static inline float frand(float a, float b) { return a + (b - a) * (random(10001) / 10000.0f); }
static inline uint16_t rgb(float r, float g, float b) {
  return lcd.color565((uint8_t)clampf(r, 0, 255), (uint8_t)clampf(g, 0, 255), (uint8_t)clampf(b, 0, 255));
}


// ---------------- MODLAR ----------------


//                  W   H   R  GAP TIRED ANGRY SAD HAPPY BOT  SL   SR  LOOKY
const ModePreset MODES[7] = {
  {"NORMAL",   0, 230, 255, {70, 92, 22, 28, 0.00, 0, 0.00, 0.00, 0.00, 1, 1, 0.00},  2500, 6000, 1.0f, 1200, 4000, 1.00f, 0, {4, 3, 1, 2, 1, 1, 2}},
  {"RELAX",  170, 150, 255, {72, 86, 24, 28, 0.42, 0, 0.00, 0.00, 0.00, 1, 1, 0.10},  4000, 8000, 1.5f, 3000, 7000, 0.50f, 0, {5, 1, 3, 1, 0, 2, 0}},
  {"HAREKETLI",120, 255, 80,{66, 94, 22, 30, 0.00, 0, 0.00, 0.00, 0.00, 1, 1, 0.00},  1500, 3500, 0.9f,  350, 1100, 1.15f, 4, {2, 2, 0, 4, 2, 1, 3}},
  {"UZGUN",   70, 130, 255, {70, 84, 22, 28, 0.00, 0, 0.55, 0.00, 0.00, 1, 1, 0.55},  3000, 6000, 1.2f, 3000, 6000, 0.40f, 0, {5, 1, 2, 0, 0, 0, 1}},
  {"ODAK",   255, 170,  40, {76, 78, 20, 26, 0.28, 0, 0.00, 0.00, 0.28, 1, 1, 0.00},  6000,10000, 1.0f, 5000, 9000, 0.30f, 0, {7, 1, 1, 0, 0, 0, 0}},
  {"ROCK",   255,  60, 200, {58, 84, 20, 30, 0.00, 0, 0.00, 0.50, 0.00, 1, 1, 0.00},  2500, 5000, 1.0f,  500,  500, 0.30f, 7, {3, 0, 0, 3, 1, 2, 0}},
  {"SAAT",   235, 235, 245, {50, 58, 16, 30, 0.00, 0, 0.00, 0.00, 0.00, 1, 1, -1.60}, 3000, 7000, 1.0f, 3000, 7000, 0.40f, 0, {6, 2, 1, 1, 0, 1, 1}},
};
const uint8_t MODE_CLOCK = 6;
const uint8_t MODE_CUSTOM = 7;
const uint8_t MODE_COUNT = 8;
// Uygulamadaki göz tasarlayıcıdan gelen özel mod (değiştirilebilir, Preferences'ta saklanır)
ModePreset customPreset = {"OZEL", 0, 230, 255, {70, 92, 22, 28, 0, 0, 0, 0, 0, 1, 1, 0}, 2500, 6000, 1.0f, 1200, 4000, 1.0f, 0, {4, 3, 1, 2, 1, 1, 2}};
static inline const ModePreset &P(uint8_t m) { return m == MODE_CUSTOM ? customPreset : MODES[m < MODE_CUSTOM ? m : 0]; }

const char *EMOTION_NAMES[E_COUNT] = {"-", "MUTLU", "KIZGIN", "UZGUN", "SASKIN", "UYKULU", "ASIK", "SASKIN?", "GOZ KIRP"};

// ---------------- DURUM ----------------
uint8_t mode = 0, rotationIdx = 0;
uint8_t prevModeBeforeRock = 0;
bool autoRock = true, musicPlaying = false;
bool rockAuto = false;                           // Rock'a müzik yüzünden kendiliğinden mi geçtik

// Ekran ışığı ayarları (telefondan 0x08 / 0x0E ile gelir, Preferences'ta saklanır)
uint8_t brightness = 200;                        // kullanıcının parlaklığı 4-255
uint16_t dimAfterS = 60;                         // bu kadar saniye dokunulmazsa kararır (0 = hiç)
uint8_t dimPct = 25;                             // kararınca parlaklığın yüzde kaçı kalır
bool nightOn = false;                            // gece uykusu
uint8_t nightFrom = 23, nightTo = 7;             // saat aralığı (yerel)
uint8_t nightLvl = 6;                            // gece ışığı 0-255 (0 = tamamen kapalı)
// Ekran ışığı durumu
uint32_t lastActivity = 0, wakeUntil = 0;
bool isDimmed = false, isAsleep = false;
int8_t forceNight = -1;                          // seri test: -1 saate göre, 0 kapalı, 1 açık
float sleepK = 0;                                // 0 uyanık, 1 gözler tamamen kapalı (gece)
uint32_t saveAt = 0;                             // ayarlar flash'a biraz sonra yazılır (kaydırırken yıpratmasın)
bool customPending = false; uint8_t customBytes[12];

Spring sp[S_COUNT];
Spring lookX, lookYs, offsetY;
float colR = 0, colG = 230, colB = 255;

uint32_t bootT = 0;

// Göz kırpma
struct {
  bool active = false; bool wink = false; int winkEye = 0;
  uint32_t start = 0, next = 0; float speed = 1;
} blink;

// Bakış
uint32_t nextLook = 0; float lookTgtX = 0, lookTgtY = 0;

// Boş davranış
Idle idle = I_NONE; uint32_t idleUntil = 0, nextIdle = 0, idleStart = 0; float idleDir = 1;
bool clockOn = true;                             // saat modu kullanılabilir mi (kapalıysa mod listesinden seçilemez)
uint8_t livelyLvl = 2;                           // 0 sakin (eski hareketler), 1 normal, 2 hareketli, 3 çok hareketli
uint8_t prevModeBeforeClock = 0;

// Yeni hareketlerin mod başına ağırlığı: ROLL UPDOWN THINK DIZZY YAWN SQUINT LOVE SHIVER BOUNCE
const uint8_t IDLE_X[8][IDLE_EXTRA] = {
  {2, 2, 2, 1, 1, 1, 1, 0, 1},   // NORMAL
  {0, 1, 2, 0, 3, 0, 1, 0, 0},   // RELAX
  {2, 1, 0, 2, 0, 0, 1, 0, 3},   // HAREKETLI
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  {2, 2, 2, 1, 1, 1, 1, 0, 1},   // OZEL
};

// Duygu
Emotion emotion = E_NONE; uint32_t emotionUntil = 0;

// Ritim
float beatPeriod = 500;              // ms (120 BPM)
uint32_t beatRef = 0;
int32_t lastBeatIdx = 0;

// Yazılar
TextLine songText, notifText;
uint32_t modeNameUntil = 0;

// Parçacıklar
Particle parts[16];
uint32_t nextFx = 0;
bool pendingTear = false;

//@sim-begin bat-vars
// Pil
int batPct = -1; bool onUSB = false; float vFilt = -1; uint32_t nextBat = 0, lowSince = 0;
// Şarj tahmini: şarj kartı pil voltajını hemen ~4.2 V'a çeker, o yüzden şarj sırasında yüzde voltajdan okunamaz
bool charging = false; float vSlow = -1; int chgStartPct = 0; uint32_t chgStart = 0; uint8_t riseCnt = 0, dropCnt = 0;
float chgPeak = 0;                               // şarj sırasında görülen en yüksek voltaj (fiş çekilince düşüşü yakalar)
uint8_t sagCnt = 0;
//@sim-end

// Bluetooth
volatile bool bleConnected = false;
volatile uint32_t bleLostAt = 0;                 // bağlantının koptuğu an (0 = bağlı / hiç bağlanmadı)
NimBLECharacteristic *chStatus = nullptr;
QueueHandle_t cmdQ;
uint32_t nextStatus = 0;
const int STATUS_LEN = 8;
uint8_t lastStatus[STATUS_LEN] = {255, 255, 255, 255, 255, 255, 255, 255};

// Durum çubuğu
bool statusDirty = true;

// Kablosuz güncelleme (OTA)
bool otaActive = false; uint32_t otaSize = 0, otaGot = 0, otaLastDraw = 0;
uint8_t otaState = 0;                           // telefona: 0 boşta, 1 yazılıyor, 2 hata
uint32_t otaLastRx = 0;                          // son parça zamanı (yarıda kalırsa iptal için)

// Albüm kapağı: telefondan JPEG gelir, sıkıştırılmış halde tutulur, çizerken açılır (RAM az)
const int COVER_SZ = 150, COVER_X = 45, COVER_Y = 2;
const uint32_t COVER_MAX = 24000;               // tam ekran 240x240 JPEG ~20 KB
uint8_t *coverJpg = nullptr, *coverRx = nullptr;
uint32_t coverLen = 0, coverExp = 0, coverGot = 0;
bool coverWant = false, coverDirty = true;
bool coverInSpr = false;                         // çizim tamponunda kapak hazır mı (bir kez açılır)
bool coverUserHide = false;                      // düğmeyle kapatıldı: yeni şarkıya kadar "hep göster" yok sayılır
uint32_t coverUntil = 0;                         // 0 = süresiz
float coverT = 0;                                // 0 = gözler, 1 = kapak (arası animasyon)
TextLine coverTitle, coverArtist;
// Tam ekran kapak (v13): 240x240, durum çubuğu ve yazılar gizli. Üstteki 24 satır ayrı küçük tamponda tutulur.
bool coverFull = false;                          // telefondan: 0x46 1 = tam ekran düzeni
bool coverPrepFull = false;                      // tamponlardaki kapak tam ekran düzeninde mi hazırlandı
bool coverFullDrawn = false;                     // durağan tam ekran kapak ekranda: her karede tekrar basma (pil)
bool coverOnTop = false;                         // durum çubuğunun yerinde kapak var (çubuk çizilmesin)
uint32_t progPos = 0, progDur = 0, progAt = 0; bool progPlaying = false;

// Saat (telefondan senkron)
bool timeValid = false; uint32_t timeLocal = 0, timeSyncMs = 0;
// Hava durumu (telefondan): kod 0 açık, 1 bulutlu, 2 yağmur, 3 kar, 4 fırtına, 5 sis
bool weatherValid = false; int8_t weatherTemp = 0; uint8_t weatherCode = 0;
// Pomodoro: 0 kapalı, 1 çalışma, 2 mola
uint8_t pomoState = 0, pomoWork = 25, pomoBreak = 5, pomoSavedMode = 0; uint32_t pomoEnd = 0;

// ---------------- EKRAN IŞIĞI (parlaklık, otomatik kararma, gece uykusu) ----------------
// BLK ucu PIN_BL'ye bağlı. Işık PWM ile kısılır; göz parlaklığı algıladığı için (gama) yumuşak bir eğri kullanılır.
float blCur = 0;                                 // şu anki ışık (0-255, kayarak hedefe gider). Açılışta 0'dan doğar.
uint32_t blLastMs = 0; int blLastDuty = -1;

void blWriteDuty(uint32_t d) {
#if PIN_BL >= 0
#if ESP_ARDUINO_VERSION_MAJOR >= 3
  ledcWrite(PIN_BL, d);
#else
  ledcWrite(BL_CH, d);
#endif
#endif
}

void blInit() {
#if PIN_BL >= 0
  gpio_hold_dis((gpio_num_t)PIN_BL);             // önceki kapanıştan kalan kilidi aç
#if ESP_ARDUINO_VERSION_MAJOR >= 3
  ledcAttach(PIN_BL, BL_FREQ, BL_BITS);
#else
  ledcSetup(BL_CH, BL_FREQ, BL_BITS);
  ledcAttachPin(PIN_BL, BL_CH);
#endif
  blWriteDuty(0);
#endif
}

// Işığı tamamen kapat ve uykuda da kapalı tut (ekran modülündeki direnç BLK'yi kendiliğinden açmasın)
void blOff() {
#if PIN_BL >= 0
  blWriteDuty(0);
#if ESP_ARDUINO_VERSION_MAJOR >= 3
  ledcDetach(PIN_BL);
#else
  ledcDetachPin(PIN_BL);
#endif
  pinMode(PIN_BL, OUTPUT);
  digitalWrite(PIN_BL, LOW);
  gpio_hold_en((gpio_num_t)PIN_BL);
#endif
}

// Kullanıcı bir şey yaptı (düğme, telefondan komut): kararmışsa aydınlan
void noteActivity() { lastActivity = millis(); }

//@sim-begin power
// Şu an gece uykusu saatinde mi? (saat telefondan gelmediyse hiç uyumaz)
bool nightNow(uint32_t now) {
  if (forceNight >= 0) return forceNight == 1;
  if (!nightOn || !timeValid || nightFrom == nightTo) return false;
  uint32_t t = timeLocal + (now - timeSyncMs) / 1000;
  int h = (t / 3600) % 24;
  return nightFrom < nightTo ? (h >= nightFrom && h < nightTo) : (h >= nightFrom || h < nightTo);
}

void updatePower(uint32_t now) {
  bool night = !otaActive && nightNow(now) && reached(now, wakeUntil);
  if (night != isAsleep) {
    isAsleep = night;
    if (!night) lastActivity = now;              // uykudan çıkınca tam parlaklıkla başla
    statusDirty = true;
    Serial.println(night ? "Gece uykusu" : "Uyandi");
  }
  // USB'deyken ve pomodoro sırasında kararmaz (masada duruyordur)
  bool dim = !isAsleep && !otaActive && dimAfterS && !onUSB && !pomoState &&
             now - lastActivity > (uint32_t)dimAfterS * 1000UL;
  if (dim != isDimmed) { isDimmed = dim; Serial.println(dim ? "Ekran karardi" : "Ekran aydinlandi"); }
}

// Hedef ışık seviyesi 0-255
float blTarget() {
  if (otaActive) return 255;
  float b = brightness;
  if (!onUSB && batPct >= 0 && batPct < 15) b *= 0.6f;      // pil azken biraz kıs
  if (isAsleep) return b < nightLvl ? b : nightLvl;
  if (isDimmed) { float d = b * dimPct / 100.0f; return d < 2 ? 2 : d; }
  return b;
}

// 0-255 seviyeyi PWM değerine çevir (gama 2.2: kaydırıcı göze doğrusal gelsin)
uint32_t blDuty(float level) {
  const uint32_t MAXD = (1u << BL_BITS) - 1;
  if (level <= 0.01f) return 0;
  uint32_t d = (uint32_t)(powf(level / 255.0f, 2.2f) * MAXD + 0.5f);
  if (d < 1) d = 1;
  return d > MAXD ? MAXD : d;
}

// Her döngüde çağrılır: ışık hedefe yumuşakça kayar (aydınlanma hızlı, kararma yavaş)
void blStep(uint32_t now) {
  float dt = (now - blLastMs) / 1000.0f;
  blLastMs = now;
  if (dt > 0.2f) dt = 0.2f;
  float tgt = blTarget();
  // Kendiliğinden kararma/uyku yavaş, kaydırıcı ve uyanma hızlı (elde gecikme hissi olmasın)
  float tau = (tgt < blCur && (isDimmed || isAsleep)) ? 0.6f : 0.12f;
  blCur += (tgt - blCur) * (1 - expf(-dt / tau));
  if (fabsf(tgt - blCur) < 0.3f) blCur = tgt;
}
//@sim-end

void blUpdate(uint32_t now) {
  blStep(now);
  int d = (int)blDuty(blCur);
  if (d != blLastDuty) { blLastDuty = d; blWriteDuty(d); }
}

// ---------------- UTF-8 metin (Türkçe yazı tipiyle doğrudan çizilir) ----------------
static void utf8Copy(const uint8_t *src, int n, char *out, int outMax) {
  int m = n < outMax - 1 ? n : outMax - 1;
  while (m > 0 && m < n && (src[m] & 0xC0) == 0x80) m--;     // harfi ortadan bölme
  memcpy(out, src, m);
  out[m] = 0;
}

// ---------------- PARÇACIKLAR ----------------
void spawn(uint8_t type, float x, float y, float vx, float vy, float life, uint8_t r, uint8_t g, uint8_t b) {
  for (auto &p : parts) if (!p.on) {
    p = {true, type, x, y, vx, vy, life, life, r, g, b};
    return;
  }
}

void updateParticles(float dt) {
  for (auto &p : parts) if (p.on) {
    p.x += p.vx * dt; p.y += p.vy * dt;
    if (p.type == P_TEAR) p.vy += 220 * dt;     // yerçekimi
    p.life -= dt;
    if (p.life <= 0 || p.y > SPR_H + 10 || p.y < -20) p.on = false;
  }
}

void drawParticles() {
  for (auto &p : parts) if (p.on) {
    float f = clampf(p.life / p.maxLife, 0, 1);
    float a = (p.type == P_TEAR) ? 1.0f : clampf(f * 2.0f, 0, 1);   // sona doğru söner
    uint16_t c = rgb(p.r * a, p.g * a, p.b * a);
    int x = (int)p.x, y = (int)p.y;
    switch (p.type) {
      case P_NOTE:
        spr.fillCircle(x, y, 4, c);
        spr.fillRect(x + 3, y - 14, 2, 14, c);
        spr.fillTriangle(x + 5, y - 14, x + 11, y - 10, x + 5, y - 8, c);
        break;
      case P_ZZZ:
        spr.setTextColor(c);
        spr.setTextDatum(lgfx::textdatum_t::middle_center);
        spr.drawString("z", x, y);
        spr.setTextSize(1);
        break;
      case P_TEAR:
        spr.fillCircle(x, y, 5, c);
        spr.fillTriangle(x - 5, y, x + 5, y, x, y - 11, c);
        break;
      case P_HEART:
        spr.fillCircle(x - 4, y, 4, c);
        spr.fillCircle(x + 4, y, 4, c);
        spr.fillTriangle(x - 8, y + 1, x + 8, y + 1, x, y + 10, c);
        break;
      case P_SPARK: {
        int s = 3 + (int)((1 - f) * 4);
        spr.fillRect(x - 1, y - s, 2, s * 2, c);
        spr.fillRect(x - s, y - 1, s * 2, 2, c);
        break;
      }
    }
  }
}

// ---------------- MOD / DUYGU ----------------
void saveSettings() {
  prefs.putUChar("mode", mode);
  prefs.putUChar("rot", rotationIdx);
}

// Sık değişen ayarlar (parlaklık kaydırıcısı, canlı göz tasarımı): 1.5 sn durunca bir kez yazılır
void saveLater() { saveAt = millis() + 1500; if (!saveAt) saveAt = 1; }

void flushSettings(uint32_t now) {
  if (!saveAt || (int32_t)(now - saveAt) < 0) return;
  saveAt = 0;
  prefs.putUChar("bri", brightness);
  prefs.putUShort("dimS", dimAfterS);
  prefs.putUChar("dimP", dimPct);
  prefs.putBool("ntOn", nightOn);
  prefs.putUChar("ntF", nightFrom);
  prefs.putUChar("ntT", nightTo);
  prefs.putUChar("ntL", nightLvl);
  prefs.putBool("clkOn", clockOn);
  prefs.putUChar("liv", livelyLvl);
  if (customPending) { customPending = false; prefs.putBytes("custom", customBytes, 12); }
}

void setMode(int m, bool save) {
  if (m < 0 || m >= MODE_COUNT) return;
  if (m == MODE_CLOCK && !clockOn)               // saat modu kapalı: saatten önceki moda (yoksa normale) düş
    m = (prevModeBeforeClock < MODE_COUNT && prevModeBeforeClock != MODE_CLOCK) ? prevModeBeforeClock : 0;
  if (m == MODE_CLOCK && mode != MODE_CLOCK) prevModeBeforeClock = mode;
  mode = m;
  rockAuto = false;                              // elle seçilen mod: müzik bitince geri dönülmez
  modeNameUntil = millis() + 1500;
  nextLook = 0;
  nextIdle = millis() + random(6000, 12000);
  if (save) saveSettings();
  Serial.printf("Mod: %s\n", P(mode).name);
}

void setRotation(int r) {
  rotationIdx = r & 3;
  lcd.setRotation(rotationIdx);
  lcd.fillScreen(BG);
  statusDirty = true;
  coverFullDrawn = false;
  saveSettings();
  Serial.printf("Yon: %d\n", rotationIdx);
}

void setEmotion(int e, uint32_t durMs) {
  if (e <= E_NONE || e >= E_COUNT) { emotion = E_NONE; return; }
  emotion = (Emotion)e;
  emotionUntil = millis() + durMs;
  if (emotion == E_WINK) { blink.active = true; blink.wink = true; blink.winkEye = random(2); blink.start = millis(); blink.speed = 1.3f; }
  if (emotion == E_SURPRISED) for (int i = 0; i < 4; i++) spawn(P_SPARK, frand(30, 210), frand(20, 60), 0, -10, 0.6f, 255, 255, 200);
  Serial.printf("Duygu: %s\n", EMOTION_NAMES[emotion]);
}

void setText(TextLine &t, const uint8_t *data, int n, uint32_t durMs) {
  utf8Copy(data, n, t.buf, sizeof(t.buf));
  t.active = t.buf[0] != 0;
  spr.setTextSize(1);
  t.width = spr.textWidth(t.buf);
  t.x = 0;
  t.until = durMs ? millis() + durMs : 0;
}

uint32_t rockAt = 0;                             // otomatik Rock'a geçiş zamanı (kapak gelirse ertelenir)

// Müzik yüzünden geçilen Rock'tan önceki moda dön (elle seçildiyse dokunma)
void leaveAutoRock() {
  rockAt = 0;
  if (rockAuto && mode == 5) setMode(prevModeBeforeRock, false);
  rockAuto = false;
}

void setMusicPlaying(bool on) {
  if (on == musicPlaying) return;
  musicPlaying = on;
  if (on) { noteActivity(); if (autoRock) rockAt = millis() + 4000; }   // kapak geliyorsa önce kapak; Rock sonra
  else leaveAutoRock();
}

void setAutoRock(bool on) {
  if (on == autoRock) return;
  autoRock = on;
  if (!on) leaveAutoRock();
  else if (musicPlaying) rockAt = millis() + 500;
}

void updateAutoRock(uint32_t now) {
  if (!rockAt || (int32_t)(now - rockAt) < 0) return;
  if (coverWant || coverT > 0) return;           // kapak ekrandayken bekle, kapanınca Rock'a geç
  if (pomoState) return;                         // pomodoro sırasında Odak/Mola bozulmasın; bitince Rock'a geçer
  rockAt = 0;
  if (autoRock && musicPlaying && mode != 5) { prevModeBeforeRock = mode; setMode(5, false); rockAuto = true; }
}

// Telefon uzun süre bağlı değilse (uygulama kapandı / güncellendi / uzaklaştın) müzikten kalan her şeyi temizle.
// Yoksa Rock modu, kapak ve eski şarkı sözü ekranda takılı kalıyordu.
void updatePhoneLost(uint32_t now) {
  if (bleConnected || !bleLostAt || now - bleLostAt < 20000) return;
  bleLostAt = 0;
  if (musicPlaying || coverWant || songText.active || progPlaying) Serial.println("Telefon yok: muzik durumu sifirlandi");
  setMusicPlaying(false);
  coverWant = false; coverUntil = 0;
  songText.active = false;
  progPlaying = false;
}

// ---------------- ÖZEL GÖZ (tasarlayıcı) ----------------
// p: w h r gap tired angry sad happy bottom R G B  (tired..bottom: 0-100)
void applyCustom(const uint8_t *p) {
  customPreset.shape[S_W] = clampf(p[0], 20, 110);
  customPreset.shape[S_H] = clampf(p[1], 20, 150);
  customPreset.shape[S_R] = clampf(p[2], 2, 60);
  customPreset.shape[S_GAP] = clampf(p[3], 0, 80);
  customPreset.shape[S_TIRED] = p[4] / 100.0f;
  customPreset.shape[S_ANGRY] = p[5] / 100.0f;
  customPreset.shape[S_SAD] = p[6] / 100.0f;
  customPreset.shape[S_HAPPY] = p[7] / 100.0f;
  customPreset.shape[S_BOTTOM] = p[8] / 100.0f;
  customPreset.r = p[9]; customPreset.g = p[10]; customPreset.b = p[11];
}

// ---------------- KABLOSUZ GÜNCELLEME ----------------
void otaDraw(const char *msg, uint16_t color) {
  lcd.startWrite();
  lcd.fillRect(0, 70, 240, 110, BG);
  lcd.setFont(&lgfx::fonts::FreeSansBold9pt7b);
  lcd.setTextSize(1);
  lcd.setTextColor(color, BG);
  lcd.setTextDatum(lgfx::textdatum_t::middle_center);
  lcd.drawString(msg, 120, 95);
  if (otaSize) {
    int pct = (int)((uint64_t)otaGot * 100 / otaSize);
    lcd.drawRoundRect(20, 120, 200, 16, 6, lcd.color565(120, 120, 130));
    lcd.fillRoundRect(23, 123, (194 * pct) / 100, 10, 4, color);
    char s[8]; snprintf(s, sizeof(s), "%d%%", pct);
    lcd.drawString(s, 120, 155);
  }
  lcd.endWrite();
}

// ---------------- POMODORO ----------------
void startPomodoro(uint8_t work, uint8_t brk) {
  if (!pomoState) {
    pomoSavedMode = rockAuto ? prevModeBeforeRock : mode;   // müzik Rock'u ise asıl moda dön
    if (rockAuto && musicPlaying) rockAt = millis();          // pomodoro bitince müzik hâlâ çalıyorsa Rock'a geç
  }
  noteActivity();
  pomoWork = work; pomoBreak = brk ? brk : 5;
  pomoState = 1;
  pomoEnd = millis() + (uint32_t)pomoWork * 60000UL;
  setMode(4, false);                              // Odak
  Serial.printf("Pomodoro: %d dk calisma, %d dk mola\n", pomoWork, pomoBreak);
}

void stopPomodoro() {
  if (!pomoState) return;
  pomoState = 0;
  setMode(pomoSavedMode, false);
  Serial.println("Pomodoro durdu");
}

void updatePomodoro(uint32_t now) {
  if (!pomoState || (int32_t)(now - pomoEnd) < 0) return;
  noteActivity();                                 // süre doldu: ekran kararmışsa aydınlansın
  if (pomoState == 1) {
    pomoState = 2;
    pomoEnd = now + (uint32_t)pomoBreak * 60000UL;
    setMode(1, false);                            // Relax
    setEmotion(E_HAPPY, 2500);
    const char *m = "Mola zamanı!";
    setText(notifText, (const uint8_t *)m, strlen(m), 3000);
  } else {
    pomoState = 1;
    pomoEnd = now + (uint32_t)pomoWork * 60000UL;
    setMode(4, false);
    setEmotion(E_SURPRISED, 1500);
    const char *m = "Çalışma zamanı!";
    setText(notifText, (const uint8_t *)m, strlen(m), 3000);
  }
}

// ---------------- BLUETOOTH ----------------
class ServerCB : public NimBLEServerCallbacks {
  void onConnect(NimBLEServer *s, NimBLEConnInfo &info) override { bleConnected = true; bleLostAt = 0; statusDirty = true; }
  void onDisconnect(NimBLEServer *s, NimBLEConnInfo &info, int reason) override {
    bleConnected = false; statusDirty = true;
    uint32_t t = millis(); bleLostAt = t ? t : 1;
  }
};

class CmdCB : public NimBLECharacteristicCallbacks {
  void onWrite(NimBLECharacteristic *c, NimBLEConnInfo &info) override {
    NimBLEAttValue v = c->getValue();
    Cmd cmd;
    cmd.len = (uint8_t)min((size_t)sizeof(cmd.data), (size_t)v.length());
    if (cmd.len == 0) return;
    memcpy(cmd.data, v.data(), cmd.len);
    uint8_t op = cmd.data[0];
    bool bulk = (op >= 0x20 && op <= 0x23) || (op >= 0x40 && op <= 0x42);
    xQueueSend(cmdQ, &cmd, bulk ? pdMS_TO_TICKS(3000) : 0);     // çizimi ana döngü yapar; OTA/kapak parçası düşmesin
  }
};

// Komut protokolü (ilk bayt = komut). DİKKAT: 0x30-0x39 ('0'-'9') metin mod komutlarına ayrılmış, yeni komut oraya konmaz.
//  '0'..'5'                  mod (nRF Connect'te metin olarak yazılabilir)
//  0x01 m                    mod (0-5)
//  0x02 r                    yön (0-3)
//  0x03 <utf8>               alt yazı (şarkı adı / söz satırı), kalıcı
//  0x04                      alt yazıyı sil
//  0x05 bpmX10(LE16) ofs(LE16)  ritim: BPM*10, sonraki vuruşa kalan ms. bpm=0 -> 120 serbest
//  0x06 e [saniye]           duygu (1 mutlu,2 kızgın,3 üzgün,4 şaşkın,5 uykulu,6 aşık,7 kafası karışık,8 göz kırp)
//  0x07 <utf8>               bildirim (şaşırır + 4 sn yazı)
//  0x08 b                    parlaklık 0-255 (sadece BLK GPIO'ya bağlıysa)
//  0x09 playing [autoRock]   müzik çalıyor 1/0, otomatik Rock 1/0
//  0x0A çalışma mola         pomodoro başlat (dakika), 0x0A 0 durdur
//  0x0B epoch(LE32) tz(LE16)  saat senkronu
//  0x0C sıcaklık kod          hava durumu
//  0x0D 12 bayt               özel göz (tasarlayıcı)
//  0x0E kararmaSn(LE16) kararmaYüzde geceAçık geceBaş geceBit geceIşık   ekran ışığı ayarları
//  0x20 boyut / 0x21 veri / 0x22 bitir / 0x23 iptal   kablosuz güncelleme
//  0x40 boyut(LE16) / 0x41 veri / 0x42 bitir   albüm kapağı (JPEG 150x150), boyut 0 = sil
//  0x43 s                    kapak göster: 0 gizle, 1 süresiz, N saniye
//  0x44 ad 0x1F sanatçı      kapak ekranındaki yazılar
//  0x45 konum(LE16) süre(LE16) çalıyor   ilerleme çubuğu (saniye)
//  0x46 f                    kapak düzeni: 0 normal, 1 tam ekran (240x240 JPEG beklenir)
void handleCmd(const Cmd &c) {
  uint8_t op = c.data[0];
  // Kullanıcının yaptığı şeyler ekranı aydınlatır (ritim, saat, ilerleme gibi arka plan verileri aydınlatmaz)
  if ((op >= '0' && op <= '7') || op == 0x01 || op == 0x02 || op == 0x06 || op == 0x07 || op == 0x08 ||
      op == 0x0D || op == 0x0E || op == 0x47 || op == 0x48 || (op == 0x43 && c.len >= 2 && c.data[1] != 0)) noteActivity();
  if (op >= '0' && op <= '7') { if (op - '0' == MODE_CLOCK && !clockOn) return; setMode(op - '0', true); return; }
  switch (op) {
    case 0x01: if (c.len >= 2 && !(c.data[1] == MODE_CLOCK && !clockOn)) setMode(c.data[1], true); break;
    case 0x02: if (c.len >= 2) setRotation(c.data[1]); break;
    case 0x03: setText(songText, c.data + 1, c.len - 1, 0); break;
    case 0x04: songText.active = false; break;
    case 0x05:
      if (c.len >= 5) {
        uint16_t bpm10 = c.data[1] | (c.data[2] << 8);
        int16_t ofs = (int16_t)(c.data[3] | (c.data[4] << 8));
        float bpm = bpm10 ? bpm10 / 10.0f : 120.0f;
        while (bpm > 180) bpm /= 2;      // yarım/çift tempo hatalarını katla
        while (bpm < 70) bpm *= 2;
        beatPeriod = 60000.0f / bpm;
        beatRef = millis() + ofs;
        Serial.printf("Ritim: %.1f BPM\n", bpm);
      }
      break;
    case 0x06: if (c.len >= 2) setEmotion(c.data[1], (c.len >= 3 ? c.data[2] : 3) * 1000UL); break;
    case 0x07:
      setText(notifText, c.data + 1, c.len - 1, 4000);
      setEmotion(E_SURPRISED, 1200);
      break;
    case 0x08:                                   // parlaklık (ışık kendisi yumuşakça kayar)
      if (c.len >= 2) {
        uint8_t nb = c.data[1] < 4 ? 4 : c.data[1];
        if (nb != brightness) { brightness = nb; saveLater(); }     // her bağlanışta aynısı gelir: boşuna yazma
      }
      break;
    case 0x0E:                                   // ekran ışığı ayarları
      if (c.len >= 8) {
        uint16_t ds = c.data[1] | (c.data[2] << 8);
        uint8_t dp = c.data[3] > 100 ? 100 : c.data[3];
        bool no = c.data[4] != 0;
        uint8_t nf = c.data[5] % 24, nt = c.data[6] % 24, nl = c.data[7];
        if (ds == dimAfterS && dp == dimPct && no == nightOn && nf == nightFrom && nt == nightTo && nl == nightLvl) break;
        dimAfterS = ds; dimPct = dp; nightOn = no; nightFrom = nf; nightTo = nt; nightLvl = nl;
        saveLater();
        Serial.printf("Isik: kararma %u sn %%%u, gece %s %02u-%02u isik %u\n", dimAfterS, dimPct, nightOn ? "acik" : "kapali", nightFrom, nightTo, nightLvl);
      }
      break;
    case 0x47:                                   // saat ve canlılık: bayrak(bit0 saat modu açık) canlılık(0-3)
      if (c.len >= 3) {
        bool co = (c.data[1] & 1) != 0;
        uint8_t lv = c.data[2] > 3 ? 3 : c.data[2];
        if (co != clockOn || lv != livelyLvl) {
          clockOn = co; livelyLvl = lv;
          if (!clockOn && mode == MODE_CLOCK) {
            uint8_t back = (prevModeBeforeClock < MODE_COUNT && prevModeBeforeClock != MODE_CLOCK) ? prevModeBeforeClock : 0;
            setMode(back, true);                 // kayıtlı mod da düzelsin (yeniden açılınca saatte başlamasın)
          }
          saveLater();
          Serial.printf("Saat modu %s, canlilik %u\n", clockOn ? "acik" : "kapali", livelyLvl);
        }
      }
      break;
    case 0x48:                                   // hareketi hemen oynat: 1..9 yeni, 1-6 eski sırayla (Idle numarası)
      if (c.len >= 2 && c.data[1] >= 1 && c.data[1] < I_COUNT && !isAsleep && emotion == E_NONE) {
        startIdle((Idle)c.data[1], millis());
        nextIdle = millis() + 6000;
      }
      break;
    case 0x09:
      if (c.len >= 3) setAutoRock(c.data[2] != 0);
      if (c.len >= 2) setMusicPlaying(c.data[1] != 0);
      break;
    case 0x0A:                                   // pomodoro: 0x0A çalışmaDk molaDk | 0x0A 0 = durdur
      if (c.len >= 3 && c.data[1] > 0) startPomodoro(c.data[1], c.data[2]);
      else stopPomodoro();
      break;
    case 0x0B:                                   // saat: epoch(LE32) + saat dilimi dakika(LE16)
      if (c.len >= 7) {
        uint32_t ep = (uint32_t)c.data[1] | ((uint32_t)c.data[2] << 8) | ((uint32_t)c.data[3] << 16) | ((uint32_t)c.data[4] << 24);
        int16_t tz = (int16_t)(c.data[5] | (c.data[6] << 8));
        timeLocal = ep + (int32_t)tz * 60;
        timeSyncMs = millis();
        timeValid = true;
      }
      break;
    case 0x0C:                                   // hava: sıcaklık(int8) + kod
      if (c.len >= 3) { weatherTemp = (int8_t)c.data[1]; weatherCode = c.data[2]; weatherValid = true; }
      break;
    case 0x0D:                                   // özel göz: 12 bayt parametre
      if (c.len >= 13) {
        applyCustom(c.data + 1);
        memcpy(customBytes, c.data + 1, 12); customPending = true;
        saveLater();                             // canlı tasarımda saniyede 8 kez gelir: flash'a durunca bir kez yaz
        if (mode != MODE_CUSTOM) setMode(MODE_CUSTOM, true);
      }
      break;
    case 0x40:                                   // kapak başla: boyut(LE16), 0 = kapağı sil
      if (c.len >= 3) {
        uint32_t n = c.data[1] | (c.data[2] << 8);
        if (coverRx) { free(coverRx); coverRx = nullptr; }
        if (n == 0) { if (coverJpg) { free(coverJpg); coverJpg = nullptr; } coverLen = 0; coverDirty = true; break; }
        if (n <= COVER_MAX) {
          coverRx = (uint8_t *)malloc(n);
          if (!coverRx && coverJpg) {              // RAM yetmedi: eski kapağı bırakıp tekrar dene
            free(coverJpg); coverJpg = nullptr; coverLen = 0; coverDirty = true;
            coverRx = (uint8_t *)malloc(n);
          }
        }
        coverExp = coverRx ? n : 0; coverGot = 0;
        if (!coverRx) Serial.printf("Kapak icin RAM yok (%u)\n", (unsigned)n);
      }
      break;
    case 0x41:                                   // kapak parçası
      if (coverRx && coverGot + (c.len - 1) <= coverExp) { memcpy(coverRx + coverGot, c.data + 1, c.len - 1); coverGot += c.len - 1; }
      break;
    case 0x42:                                   // kapak bitti
      if (coverRx) {
        if (coverGot == coverExp && coverExp > 4 && coverRx[0] == 0xFF && coverRx[1] == 0xD8) {
          bool same = coverJpg && coverLen == coverExp && memcmp(coverJpg, coverRx, coverLen) == 0;
          if (same) {
            free(coverRx);                       // aynı kapak: hiçbir şey yapma
          } else {
            if (coverJpg) free(coverJpg);
            coverJpg = coverRx; coverLen = coverExp; coverDirty = true;
            if (coverT >= 1) coverT = 0.46f;     // ekrandaysa yeni kapak perdeyle açılsın
            Serial.printf("Kapak alindi: %u bayt, bos heap %u\n", (unsigned)coverLen, ESP.getFreeHeap());
          }
        } else {
          Serial.printf("Kapak eksik geldi (%u/%u)\n", (unsigned)coverGot, (unsigned)coverExp);
          free(coverRx);
        }
        coverRx = nullptr;
      }
      break;
    case 0x43:                                   // kapak göster: 0 gizle, 1 süresiz, N>=2 N saniye
      if (c.len >= 2) {
        uint8_t v = c.data[1];
        if (v == 1 && coverUserHide) break;      // kullanıcı düğmeyle kapattı, yeni şarkıyı bekle
        if (v >= 2) coverUserHide = false;
        coverWant = v != 0;
        coverUntil = v >= 2 ? millis() + v * 1000UL : 0;
      }
      break;
    case 0x44: {                                 // şarkı adı \x1F sanatçı
      int n = c.len - 1, sep = -1;
      for (int i = 0; i < n; i++) if (c.data[1 + i] == 0x1F) { sep = i; break; }
      {                                          // şarkı değiştiyse düğmeyle gizleme sıfırlanır
        char tmp[161]; utf8Copy(c.data + 1, sep < 0 ? n : sep, tmp, sizeof(tmp));
        if (strcmp(tmp, coverTitle.buf) != 0) { coverUserHide = false; noteActivity(); }   // yeni şarkı
      }
      if (sep < 0) { setText(coverTitle, c.data + 1, n, 0); coverArtist.active = false; }
      else { setText(coverTitle, c.data + 1, sep, 0); setText(coverArtist, c.data + 2 + sep, n - sep - 1, 0); }
      break;
    }
    case 0x45:                                   // konum(LE16 sn) süre(LE16 sn) çalıyor
      if (c.len >= 6) {
        progPos = (uint32_t)(c.data[1] | (c.data[2] << 8)) * 1000UL;
        progDur = (uint32_t)(c.data[3] | (c.data[4] << 8)) * 1000UL;
        progPlaying = c.data[5] != 0; progAt = millis();
      }
      break;
    case 0x46:                                   // kapak düzeni: 0 normal (150 px + yazılar), 1 tam ekran (240 px, her şey gizli)
      if (c.len >= 2) {
        bool f = c.data[1] != 0;
        if (f != coverFull) { coverFull = f; coverDirty = true; coverFullDrawn = false; }
      }
      break;
    case 0x20:                                   // OTA başla: boyut(LE32)
      if (c.len >= 5) {
        if (otaActive) { Update.abort(); otaActive = false; }   // yarım kalmış eski deneme varsa temizle
        otaSize = (uint32_t)c.data[1] | ((uint32_t)c.data[2] << 8) | ((uint32_t)c.data[3] << 16) | ((uint32_t)c.data[4] << 24);
        otaGot = 0; otaLastRx = millis();
        if (Update.begin(otaSize)) {
          otaActive = true;
          lcd.fillScreen(BG);
          otaDraw("Yazilim guncelleniyor", lcd.color565(0, 230, 255));
          otaNotify(1);
        } else {
          Serial.printf("OTA baslamadi: %s\n", Update.errorString());
          otaSize = 0;
          otaNotify(2);
        }
      }
      break;
    case 0x21:                                   // OTA veri parçası
      if (otaActive) {
        otaLastRx = millis();
        size_t n = c.len - 1;
        if (Update.write((uint8_t *)c.data + 1, n) != n) {
          Serial.printf("OTA yazma hatasi: %s\n", Update.errorString());
          Update.abort(); otaActive = false;
          otaDraw("Guncelleme hatasi", lcd.color565(255, 60, 60));
          otaNotify(2);
          delay(1500);
          lcd.fillScreen(BG); statusDirty = true; otaSize = 0;
        } else {
          otaGot += n;
          if (millis() - otaLastDraw > 300) { otaLastDraw = millis(); otaDraw("Yazilim guncelleniyor", lcd.color565(0, 230, 255)); }
        }
      }
      break;
    case 0x22:                                   // OTA bitir: doğrula ve yeniden başla
      if (otaActive) {
        otaActive = false;
        if (Update.end(true)) {
          otaGot = otaSize;
          otaDraw("Tamam! Yeniden basliyor", lcd.color565(80, 230, 120));
          delay(1200);
          ESP.restart();
        } else {
          Serial.printf("OTA dogrulama hatasi: %s\n", Update.errorString());
          otaDraw("Dosya hatali, iptal", lcd.color565(255, 60, 60));
          otaNotify(2);
          delay(1500);
          lcd.fillScreen(BG); statusDirty = true; otaSize = 0;
        }
      }
      break;
    case 0x23:                                   // OTA iptal
      if (otaActive) { Update.abort(); otaActive = false; otaSize = 0; lcd.fillScreen(BG); statusDirty = true; }
      otaNotify(0);
      break;
  }
}

void setupBLE() {
  char name[16];
  uint64_t mac = ESP.getEfuseMac();
  snprintf(name, sizeof(name), "Goz-%04X", (unsigned)((mac >> 32) & 0xFFFF));
  NimBLEDevice::init(name);
  NimBLEDevice::setMTU(185);
  NimBLEServer *srv = NimBLEDevice::createServer();
  srv->setCallbacks(new ServerCB());
  srv->advertiseOnDisconnect(true);
  NimBLEService *svc = srv->createService(SERVICE_UUID);
  NimBLECharacteristic *chCmd = svc->createCharacteristic(CMD_UUID, NIMBLE_PROPERTY::WRITE | NIMBLE_PROPERTY::WRITE_NR);
  chCmd->setCallbacks(new CmdCB());
  chStatus = svc->createCharacteristic(STATUS_UUID, NIMBLE_PROPERTY::READ | NIMBLE_PROPERTY::NOTIFY);
  uint8_t st[STATUS_LEN];
  fillStatus(st);
  chStatus->setValue(st, STATUS_LEN);
  svc->start();
  NimBLEAdvertising *adv = NimBLEDevice::getAdvertising();
  adv->setName(name);
  adv->addServiceUUID(SERVICE_UUID);
  adv->enableScanResponse(true);
  adv->start();
  Serial.printf("Bluetooth adi: %s\n", name);
}

// Durum: mod, yön, pil%, bayrak (1 USB/şarj, 2 çalıyor), FW sürümü, OTA durumu, parlaklık, ışık (1 kararmış, 2 gece uykusu)
void fillStatus(uint8_t *st) {
  st[0] = mode; st[1] = rotationIdx; st[2] = (uint8_t)(batPct < 0 ? 0 : batPct);
  st[3] = (uint8_t)((onUSB ? 1 : 0) | (musicPlaying ? 2 : 0));
  st[4] = FW_VERSION; st[5] = otaState;
  st[6] = brightness;
  st[7] = (uint8_t)((isDimmed ? 1 : 0) | (isAsleep ? 2 : 0));
}

void updateStatusChar(uint32_t now) {
  if (!chStatus) return;
  uint8_t st[STATUS_LEN];
  fillStatus(st);
  bool changed = memcmp(st, lastStatus, STATUS_LEN) != 0;
  if (changed || (int32_t)(now - nextStatus) >= 0) {
    chStatus->setValue(st, STATUS_LEN);
    if (bleConnected) chStatus->notify();
    memcpy(lastStatus, st, STATUS_LEN);
    nextStatus = now + 10000;
  }
}

// Güncelleme durumunu hemen telefona bildir
void otaNotify(uint8_t s) {
  otaState = s;
  if (!chStatus) return;
  uint8_t st[STATUS_LEN];
  fillStatus(st);
  chStatus->setValue(st, STATUS_LEN);
  if (bleConnected) chStatus->notify();
  memcpy(lastStatus, st, STATUS_LEN);
}

// ---------------- PİL ----------------
// Pil bitti: ekranı ve ışığı kapat, çok az akım çeken uykuya gir (anahtarı kapatıp açınca yeniden başlar)
void batteryShutdown() {
  Serial.println("Pil bitti, kapaniyorum");
  blCur = 120; blWriteDuty(blDuty(120));         // yazı okunabilsin
  lcd.fillScreen(BG);
  lcd.setFont(&lgfx::fonts::FreeSansBold9pt7b);
  lcd.setTextColor(lcd.color565(255, 60, 60));
  lcd.setTextDatum(lgfx::textdatum_t::middle_center);
  lcd.drawString("PIL BITTI", 120, 120);
  delay(3000);
  blOff();
  lcd.sleep();
  NimBLEDevice::deinit(true);
  // Hafif uyku pinleri olduğu gibi tutar (ışık kapalı kalır). Saatte bir uyanıp tekrar uyur.
  while (true) {
    esp_sleep_enable_timer_wakeup(3600ULL * 1000000ULL);
    esp_light_sleep_start();
  }
}

//@sim-begin battery
int voltToPct(float v) {
  static const float V[] = {3.30, 3.50, 3.60, 3.65, 3.70, 3.75, 3.80, 3.90, 4.00, 4.10, 4.20};
  static const int P[] = {0, 5, 12, 20, 30, 40, 50, 65, 80, 90, 100};
  if (v <= V[0]) return 0;
  if (v >= V[10]) return 100;
  for (int i = 1; i < 11; i++)
    if (v < V[i]) return P[i - 1] + (int)((P[i] - P[i - 1]) * (v - V[i - 1]) / (V[i] - V[i - 1]));
  return 100;
}

void readBattery(uint32_t now) {
#if HAS_BATTERY_DIVIDER
  uint32_t sum = 0;
  for (int i = 0; i < 32; i++) sum += analogReadMilliVolts(PIN_BAT);
  float v = sum / 32.0f * 2.0f / 1000.0f;
  vFilt = (vFilt < 0) ? v : vFilt * 0.85f + v * 0.15f;
  if (vSlow < 0) vSlow = v;

  // Şarj başladı mı / bitti mi: voltaj birden ~0.07 V+ sıçrar / düşer
  float d = v - vSlow;
  if (!charging) {
    if (d > 0.07f) {
      if (++riseCnt >= 2) {
        charging = true; riseCnt = 0; dropCnt = 0; sagCnt = 0; chgStart = now;
        chgStartPct = batPct >= 0 ? batPct : voltToPct(vSlow);
        vSlow = v; chgPeak = vFilt;
        Serial.printf("Sarj basladi (%%%d)\n", chgStartPct);
      }
    } else { riseCnt = 0; vSlow = vSlow * 0.9f + v * 0.1f; }
  } else {
    // Şarjda voltaj sadece yükselir ya da sabit kalır. Birden düşerse (fiş çekildi) ya da en yüksek
    // değerden belirgin aşağı indiyse (dolu pilde fiş çekildi / şarj bitti, yavaş düşüş) şarj bitmiştir.
    if (vFilt > chgPeak) chgPeak = vFilt;
    if (vFilt < chgPeak - 0.035f) { if (sagCnt < 255) sagCnt++; } else sagCnt = 0;
    bool sudden = d < -0.07f;
    if (sudden) dropCnt++; else dropCnt = 0;
    if (dropCnt >= 2 || sagCnt >= 30) {           // 4 sn ani düşüş ya da 1 dk boyunca tepe değerin altında
      charging = false; dropCnt = 0; sagCnt = 0; vSlow = v; vFilt = v;
      Serial.println("Sarj bitti / cikarildi");
    } else if (!sudden) vSlow = vSlow * 0.9f + v * 0.1f;
  }

  bool usb = vFilt > 4.45f || charging;           // 4.45 V üstü: USB doğrudan karta takılı
  int pct;
  if (charging) {
    // ~900 mAh, şarj kartı ~1 A: dakikada ~%1.3 -> 45 sn'de %1. Tam dolmadan %99'da bekler.
    pct = chgStartPct + (int)((now - chgStart) / 45000);
    if (pct > 99) pct = (v >= 4.17f && now - chgStart > 600000) ? 100 : 99;
  } else {
    pct = voltToPct(vFilt);
    // pilde giderken gürültüden yükselmesin: sadece azalır (5'ten büyük sıçrama hariç)
    if (!onUSB && batPct >= 0 && pct > batPct && pct - batPct < 5) pct = batPct;
  }
  if (usb != onUSB || abs(pct - batPct) >= 1) statusDirty = true;
  onUSB = usb; batPct = pct;
  // Kritik pil: 30 sn boyunca 3.30 V altı -> kapan (LiPo'yu korur)
  if (!onUSB && vFilt > 2.5f && vFilt < 3.30f) {
    if (!lowSince) lowSince = now;
    if (now - lowSince > 30000) batteryShutdown();
  } else lowSince = 0;
#endif
}
//@sim-end

void drawStatusBar() {
  statusDirty = false;
  lcd.startWrite();
  lcd.fillRect(0, 0, 240, STATUS_H, BG);
  // Bluetooth noktası
  lcd.fillCircle(14, 12, 4, bleConnected ? lcd.color565(40, 120, 255) : lcd.color565(50, 50, 60));
#if HAS_BATTERY_DIVIDER
  int x = 198, y = 6, w = 28, h = 13;
  uint16_t frame = lcd.color565(180, 180, 190);
  lcd.drawRoundRect(x, y, w, h, 3, frame);
  lcd.fillRect(x + w, y + 4, 3, h - 8, frame);
  if (onUSB) {
    uint16_t yel = lcd.color565(255, 220, 0);
    if (charging && batPct >= 0) {                 // şarj: yeşil doluluk + şimşek + yüzde
      int fw = (w - 4) * batPct / 100; if (fw < 1) fw = 1;
      lcd.fillRect(x + 2, y + 2, fw, h - 4, lcd.color565(40, 150, 70));
      lcd.setFont(&lgfx::fonts::Font0);
      lcd.setTextSize(1);
      lcd.setTextColor(yel, BG);
      lcd.setTextDatum(lgfx::textdatum_t::middle_right);
      char s[6]; snprintf(s, sizeof(s), "%d%%", batPct);
      lcd.drawString(s, x - 4, y + 7);
    }
    lcd.fillTriangle(x + 16, y + 2, x + 9, y + 7, x + 14, y + 7, yel);
    lcd.fillTriangle(x + 12, y + 6, x + 18, y + 6, x + 11, y + 11, yel);
  } else if (batPct >= 0) {
    uint16_t c = batPct > 40 ? lcd.color565(60, 220, 90) : (batPct > 15 ? lcd.color565(255, 210, 0) : lcd.color565(255, 50, 50));
    int fw = (w - 4) * batPct / 100;
    if (fw < 1) fw = 1;
    lcd.fillRect(x + 2, y + 2, fw, h - 4, c);
    lcd.setFont(&lgfx::fonts::Font0);
    lcd.setTextSize(1);
    lcd.setTextColor(frame, BG);
    lcd.setTextDatum(lgfx::textdatum_t::middle_right);
    char s[6]; snprintf(s, sizeof(s), "%d%%", batPct);
    lcd.drawString(s, x - 4, y + 7);
  }
#endif
  lcd.endWrite();
}

// ---------------- GÖZ ÇİZİMİ ----------------
void drawEye(float cx, float cy, float w, float h, float r, float open, bool left, uint16_t col,
             float tired, float angry, float sad, float happy, float bottom) {
  float he = h * open;
  if (he < 4) {                                   // kapalı göz: ince çizgi
    spr.fillRoundRect((int)(cx - w / 2), (int)(cy - 2), (int)w, 4, 2, col);
    return;
  }
  int x0 = (int)(cx - w / 2), y0 = (int)(cy - he / 2), iw = (int)w, ih = (int)he;
  int rr = (int)min(r, he / 2);
#if USE_SMOOTH
  spr.fillSmoothRoundRect(x0, y0, iw, ih, rr, col);
#else
  spr.fillRoundRect(x0, y0, iw, ih, rr, col);
#endif
  // Göz kapakları (arka plan rengiyle kesilir)
  if (tired > 0.01f) spr.fillRect(x0 - 2, y0 - 2, iw + 4, (int)(he * 0.55f * tired) + 2, BG);
  int xin = left ? x0 + iw + 2 : x0 - 2, xout = left ? x0 - 2 : x0 + iw + 2;
  if (angry > 0.01f) spr.fillTriangle(xout, y0 - 2, xin, y0 - 2, xin, y0 + (int)(he * 0.6f * angry), BG);
  if (sad > 0.01f) spr.fillTriangle(xin, y0 - 2, xout, y0 - 2, xout, y0 + (int)(he * 0.6f * sad), BG);
  if (bottom > 0.01f) { int d = (int)(he * 0.5f * bottom); spr.fillRect(x0 - 2, y0 + ih - d, iw + 4, d + 3, BG); }
  if (happy > 0.02f) {                             // alttan yay şeklinde kesik: ^ ^
    float hp = clampf(happy, 0, 0.6f);
    int ey = y0 + (int)(he * (1.75f - 1.4f * hp));
    spr.fillEllipse((int)cx, ey, (int)(w * 0.75f), (int)(he * 0.75f), BG);
  }
}

void drawHeadphones(float bob, uint16_t accent) {
  int cy = 112 + (int)bob;
  uint16_t band = rgb(90, 90, 100), cup = rgb(55, 55, 65);
  spr.fillArc(120, cy, 100, 109, 200, 340, band);
  spr.fillRoundRect(4, cy - 44, 32, 70, 10, cup);
  spr.fillRoundRect(204, cy - 44, 32, 70, 10, cup);
  spr.fillRoundRect(10, cy - 34, 20, 50, 6, accent);
  spr.fillRoundRect(210, cy - 34, 20, 50, 6, accent);
}

// 7 segment rakam (a=1 b=2 c=4 d=8 e=16 f=32 g=64); söner segmentler çok koyu çizilir
void drawSeg7(int x, int y, int w, int h, int t, int d, uint16_t on, uint16_t off) {
  static const uint8_t SEG[10] = {0x3F, 0x06, 0x5B, 0x4F, 0x66, 0x6D, 0x7D, 0x07, 0x7F, 0x6F};
  uint8_t m = (d >= 0 && d <= 9) ? SEG[d] : 0x40;
  int h2 = h / 2;
  spr.fillRoundRect(x + t / 2, y - t / 2, w - t, t, t / 2, (m & 1) ? on : off);           // a
  spr.fillRoundRect(x + t / 2, y + h2 - t / 2, w - t, t, t / 2, (m & 64) ? on : off);     // g
  spr.fillRoundRect(x + t / 2, y + h - t / 2, w - t, t, t / 2, (m & 8) ? on : off);       // d
  spr.fillRoundRect(x + w - t, y + t / 2, t, h2 - t, t / 2, (m & 2) ? on : off);          // b
  spr.fillRoundRect(x + w - t, y + h2 + t / 2, t, h2 - t, t / 2, (m & 4) ? on : off);     // c
  spr.fillRoundRect(x, y + h2 + t / 2, t, h2 - t, t / 2, (m & 16) ? on : off);            // e
  spr.fillRoundRect(x, y + t / 2, t, h2 - t, t / 2, (m & 32) ? on : off);                 // f
}

void drawWeatherIcon(int cx, int cy, uint8_t code) {
  uint16_t yel = rgb(255, 210, 60), gry = rgb(170, 175, 190), blu = rgb(110, 180, 255), wht = rgb(240, 240, 255);
  if (code == 0) {                                // güneş
    spr.fillCircle(cx, cy, 6, yel);
    for (int i = 0; i < 8; i++) {
      float a = i * PI / 4;
      spr.drawLine(cx + (int)(9 * cosf(a)), cy + (int)(9 * sinf(a)), cx + (int)(12 * cosf(a)), cy + (int)(12 * sinf(a)), yel);
    }
    return;
  }
  if (code == 5) {                                // sis
    for (int i = 0; i < 3; i++) spr.fillRoundRect(cx - 11, cy - 6 + i * 5, 22, 3, 1, gry);
    return;
  }
  spr.fillCircle(cx - 5, cy, 5, gry); spr.fillCircle(cx + 2, cy - 3, 7, gry); spr.fillCircle(cx + 8, cy + 1, 4, gry);
  spr.fillRect(cx - 5, cy, 13, 5, gry);
  if (code == 2) for (int i = 0; i < 3; i++) spr.drawLine(cx - 5 + i * 5, cy + 8, cx - 7 + i * 5, cy + 12, blu);
  if (code == 3) for (int i = 0; i < 3; i++) spr.fillCircle(cx - 5 + i * 5, cy + 10, 1, wht);
  if (code == 4) spr.fillTriangle(cx, cy + 6, cx - 3, cy + 12, cx + 3, cy + 10, yel);
}

void drawClock(uint32_t now, uint16_t col) {
  int hh = -1, mm = -1, ss = 0;
  if (timeValid) {
    uint32_t t = timeLocal + (now - timeSyncMs) / 1000;
    hh = (t / 3600) % 24; mm = (t / 60) % 60; ss = t % 60;
  }
  uint16_t off = rgb(colR * 0.08f, colG * 0.08f, colB * 0.08f);
  const int W = 30, H = 50, T = 7, G = 8, top = 112;
  int x = 120 - (4 * W + 3 * G + 14) / 2;
  drawSeg7(x, top, W, H, T, hh < 0 ? -1 : hh / 10, col, off); x += W + G;
  drawSeg7(x, top, W, H, T, hh < 0 ? -1 : hh % 10, col, off); x += W + G;
  uint16_t dot = (ss % 2 == 0 || !timeValid) ? col : off;
  spr.fillCircle(x + 3, top + 15, 3, dot); spr.fillCircle(x + 3, top + 35, 3, dot); x += 14;
  drawSeg7(x, top, W, H, T, mm < 0 ? -1 : mm / 10, col, off); x += W + G;
  drawSeg7(x, top, W, H, T, mm < 0 ? -1 : mm % 10, col, off);
  if (weatherValid) {
    char s[12]; snprintf(s, sizeof(s), "%d°C", weatherTemp);
    int tw = spr.textWidth(s), total = 30 + tw;
    int x0 = 120 - total / 2;
    drawWeatherIcon(x0 + 11, SPR_H - 22, weatherCode);
    spr.setTextColor(rgb(225, 225, 235));
    spr.setTextDatum(lgfx::textdatum_t::middle_left);
    spr.drawString(s, x0 + 30, SPR_H - 22);
  } else if (!timeValid) {
    spr.setTextColor(rgb(150, 150, 160));
    spr.setTextDatum(lgfx::textdatum_t::middle_center);
    spr.drawString("Telefona bağlan", 120, SPR_H - 22);
  }
}

void drawBottomText(uint32_t now, float dt, uint16_t col) {
  TextLine *t = nullptr;
  if (notifText.active && (notifText.until == 0 || !reached(now, notifText.until))) t = &notifText;
  else { notifText.active = false; if (songText.active) t = &songText; }
  const int ty = SPR_H - 16;
  if (t != &notifText && pomoState) {             // pomodoro geri sayımı + ilerleme çubuğu
    uint32_t rem = (int32_t)(pomoEnd - now) > 0 ? (pomoEnd - now + 999) / 1000 : 0;
    char s[24]; snprintf(s, sizeof(s), "%s  %02u:%02u", pomoState == 1 ? "Odak" : "Mola", (unsigned)(rem / 60), (unsigned)(rem % 60));
    spr.setTextSize(1);
    spr.setTextColor(col);
    spr.setTextDatum(lgfx::textdatum_t::middle_center);
    spr.drawString(s, 120, ty - 4);
    float total = (pomoState == 1 ? pomoWork : pomoBreak) * 60000.0f;
    float frac = clampf(1.0f - (int32_t)(pomoEnd - now) / total, 0, 1);
    spr.fillRoundRect(20, SPR_H - 10, 200, 3, 1, rgb(40, 40, 48));
    spr.fillRoundRect(20, SPR_H - 10, (int)(200 * frac), 3, 1, col);
    return;
  }
  if (t != &notifText && mode == MODE_CLOCK) { drawClock(now, col); return; }
  if (!reached(now, modeNameUntil) && !t) {
    spr.setTextSize(1);
    spr.setTextColor(col);
    spr.setTextDatum(lgfx::textdatum_t::middle_center);
    spr.drawString(P(mode).name, 120, ty);
    return;
  }
  if (!t) return;
  spr.setTextSize(1);
  spr.setTextColor(rgb(235, 235, 240));
  spr.setTextDatum(lgfx::textdatum_t::middle_left);
  const int margin = 10, avail = 240 - margin * 2;
  if (t->width <= avail) {
    spr.drawString(t->buf, 120 - t->width / 2, ty);
  } else {                                         // kayan yazı (zamana bağlı, px/sn)
    t->x += 45.0f * dt;
    int gap = 50, period = t->width + gap;
    if (t->x > period) t->x -= period;
    int x = margin - (int)t->x;
    spr.setClipRect(margin, ty - 12, avail, 24);
    spr.drawString(t->buf, x, ty);
    spr.drawString(t->buf, x + period, ty);
    spr.clearClipRect();
  }
}

// ---------------- GÜNCELLEME ----------------
float blinkOpen(uint32_t now, int eye) {
  const ModePreset &M = P(mode);
  if (!blink.active && reached(now, blink.next)) {
    blink.active = true; blink.wink = false; blink.start = now;
    blink.speed = M.blinkSpeed * ((idle == I_SLEEPY || emotion == E_SLEEPY) ? 1.8f : 1.0f);
  }
  if (!blink.active) return 1.0f;
  if (blink.wink && eye != blink.winkEye) return 1.0f;
  float closeT = 70 * blink.speed, holdT = 45 * blink.speed, openT = 190 * blink.speed;
  float t = now - blink.start;
  if (t < closeT) { float p = t / closeT; return 1 - p * p; }                  // hızlı kapanış
  if (t < closeT + holdT) return 0;
  if (t < closeT + holdT + openT) { float p = (t - closeT - holdT) / openT; return 1 - (1 - p) * (1 - p); }  // yavaş açılış
  return 1.0f;
}

void finishBlinkIfDone(uint32_t now) {
  if (!blink.active) return;
  float total = (70 + 45 + 190) * blink.speed;
  if (now - blink.start < total) return;
  blink.active = false;
  const ModePreset &M = P(mode);
  if (!blink.wink && random(100) < 12) blink.next = now + 120;                   // çift kırpma
  else blink.next = now + random(M.blinkMin, M.blinkMax);
  blink.wink = false;
}

Idle pickIdle() {
  const uint8_t *w = P(mode).idleW;
  const uint8_t *x = IDLE_X[mode < 8 ? mode : 0];
  bool extra = livelyLvl >= 1;
  int sum = 0;
  for (int i = 0; i < 7; i++) sum += w[i];
  if (extra) for (int i = 0; i < IDLE_EXTRA; i++) sum += x[i];
  if (sum <= 0) return I_NONE;
  int r = random(sum);
  for (int i = 0; i < 7; i++) { if (r < w[i]) return (Idle)i; r -= w[i]; }
  if (extra) for (int i = 0; i < IDLE_EXTRA; i++) { if (r < x[i]) return (Idle)(I_LOOKAROUND + 1 + i); r -= x[i]; }
  return I_NONE;
}

// Bir hareketi başlatır (rastgele seçimden ya da uygulamadan)
void startIdle(Idle id, uint32_t now) {
  idle = id;
  idleDir = random(2) ? 1 : -1;
  idleStart = now;
  uint32_t dur = 0;
  switch (idle) {
    case I_CURIOUS: dur = 1600; break;
    case I_SLEEPY: dur = 2500; break;
    case I_HAPPY: dur = 1500; break;
    case I_SURPRISE: dur = 700; spawn(P_SPARK, 120 + idleDir * 90, 30, 0, -15, 0.6f, 255, 255, 200); break;
    case I_WINK: dur = 400; blink.active = true; blink.wink = true; blink.winkEye = random(2); blink.start = now; blink.speed = 1.3f; break;
    case I_LOOKAROUND: dur = 1300; break;
    case I_ROLL: dur = 1700; break;
    case I_UPDOWN: dur = 1500; break;
    case I_THINK: dur = 2300; break;
    case I_DIZZY: dur = 1900; for (int i = 0; i < 3; i++) spawn(P_SPARK, 70 + i * 50, 30, 0, -10, 1.0f, 255, 240, 140); break;
    case I_YAWN: dur = 2700; break;
    case I_SQUINT: dur = 1700; break;
    case I_LOVE: dur = 1900; for (int i = 0; i < 4; i++) spawn(P_HEART, frand(50, 190), frand(120, 160), frand(-12, 12), -38, 1.5f, 255, 90, 170); break;
    case I_SHIVER: dur = 1500; break;
    case I_BOUNCE: dur = 1300; break;
    default: break;
  }
  idleUntil = now + dur;
}

void updateBehavior(uint32_t now) {
  const ModePreset &M = P(mode);
  // Boş davranış seçimi
  if (idle != I_NONE && reached(now, idleUntil)) idle = I_NONE;
  if (reached(now, nextIdle) && emotion == E_NONE && !isAsleep) {
    startIdle(pickIdle(), now);
    // sakin: seyrek, hareketli: sık (ms)
    static const uint8_t SCALE[4] = {200, 100, 60, 35};
    nextIdle = now + (uint32_t)random(7000, 16000) * SCALE[livelyLvl & 3] / 100;
  }
  // Bakış
  if (idle == I_CURIOUS) { lookTgtX = 0.9f * idleDir; lookTgtY = 0; }
  else if (idle == I_LOOKAROUND) {
    uint32_t t = 1300 - (idleUntil - now);
    lookTgtX = t < 450 ? -0.8f : (t < 900 ? 0.8f : 0); lookTgtY = 0;
  } else if (idle >= I_ROLL && idle < I_COUNT && idle != I_LOVE && idle != I_BOUNCE && idle != I_YAWN) {
    float t = (float)(now - idleStart);
    switch (idle) {
      case I_ROLL: { float a = clampf(t / 1700.0f, 0, 1) * 2 * PI; lookTgtX = -0.8f * cosf(a) * idleDir; lookTgtY = -0.7f * sinf(a); break; }
      case I_UPDOWN: lookTgtX = 0; lookTgtY = t < 500 ? -0.9f * idleDir : (t < 1000 ? 0.9f * idleDir : 0); break;
      case I_THINK: lookTgtX = 0.65f * idleDir; lookTgtY = -0.8f; break;
      case I_DIZZY: lookTgtX = 0.8f * sinf(t / 110.0f); lookTgtY = 0.25f * cosf(t / 150.0f); break;
      case I_SQUINT: lookTgtX = 0.5f * idleDir; lookTgtY = 0; break;
      case I_SHIVER: lookTgtX = ((int)(t / 60.0f) & 1) ? 0.22f : -0.22f; lookTgtY = 0; break;
      default: break;
    }
  } else if (idle == I_YAWN || idle == I_LOVE || idle == I_BOUNCE) {
    lookTgtX = 0; lookTgtY = 0;
  } else if (reached(now, nextLook)) {
    if (mode == 5) {
      lookTgtX = 0; lookTgtY = 0; nextLook = now + 1000;          // Rock: ritimle sallanır
    } else {
      bool center = random(100) < 35;
      lookTgtX = center ? 0 : frand(-M.lookRange, M.lookRange);
      lookTgtY = center ? 0 : frand(-0.5f, 0.5f) * M.lookRange;
      nextLook = now + random(M.lookMin, M.lookMax);
    }
  }
  if (emotion != E_NONE && reached(now, emotionUntil)) emotion = E_NONE;

  // Mod efektleri
  if (reached(now, nextFx)) {
    if (isAsleep) {                               // uyurken: z z z
      if (sleepK > 0.8f) spawn(P_ZZZ, 150 + frand(-8, 8), 70, 10, -14, 2.6f, colR * 0.8f, colG * 0.8f, colB * 0.8f);
      nextFx = now + random(2600, 4200);
    }
    else if (mode == 1) { spawn(P_ZZZ, 175 + frand(-5, 5), 50, 12, -18, 2.2f, 170, 150, 255); nextFx = now + random(4000, 7000); }
    else if (mode == 2 && random(100) < 40) { spawn(P_SPARK, frand(20, 220), frand(10, 40), 0, -8, 0.5f, 200, 255, 150); nextFx = now + random(1500, 3000); }
    else if (mode == 3) { pendingTear = true; nextFx = now + random(3500, 6500); }
    else if (mode == MODE_CLOCK && weatherValid && (weatherCode == 2 || weatherCode == 4)) { spawn(P_TEAR, frand(10, 230), -5, 0, 40, 3.0f, 120, 180, 255); nextFx = now + random(250, 700); }
    else if (mode == MODE_CLOCK && weatherValid && weatherCode == 3) { spawn(P_SPARK, frand(10, 230), -5, frand(-6, 6), 22, 6.0f, 235, 240, 255); nextFx = now + random(300, 800); }
    else nextFx = now + 2000;
  }
}

void composeTargets(uint32_t now, float *tgt, uint8_t &r, uint8_t &g, uint8_t &b) {
  const ModePreset &M = P(mode);
  for (int i = 0; i < S_COUNT; i++) tgt[i] = M.shape[i];
  r = M.r; g = M.g; b = M.b;
  // Boş davranışlar
  if (idle == I_SLEEPY) tgt[S_TIRED] = max(tgt[S_TIRED], 0.5f);
  if (idle == I_HAPPY) tgt[S_HAPPY] = max(tgt[S_HAPPY], 0.45f);
  if (idle == I_SURPRISE) { tgt[S_SIZE_L] = tgt[S_SIZE_R] = 1.15f; tgt[S_TIRED] = 0; }
  {
    float it = (float)(now - idleStart);
    switch (idle) {
      case I_ROLL: tgt[S_TIRED] = max(tgt[S_TIRED], 0.25f); break;
      case I_THINK: tgt[S_SIZE_L] = 0.85f; tgt[S_SIZE_R] = 1.1f; tgt[S_TIRED] = max(tgt[S_TIRED], 0.12f); break;
      case I_DIZZY: tgt[S_SIZE_L] = 1.1f; tgt[S_SIZE_R] = 0.9f; tgt[S_SAD] = max(tgt[S_SAD], 0.25f); break;
      case I_YAWN:                                  // esneme: gözler yavaşça sıkılıp kısılır, sonunda gevşer
        if (it > 300 && it < 1900) { tgt[S_TIRED] = 0.8f; tgt[S_H] *= 0.8f; tgt[S_SIZE_L] = tgt[S_SIZE_R] = 1.05f; }
        else tgt[S_TIRED] = max(tgt[S_TIRED], 0.45f);
        break;
      case I_SQUINT: tgt[S_ANGRY] = max(tgt[S_ANGRY], 0.35f); tgt[S_H] *= 0.62f; tgt[S_TIRED] = max(tgt[S_TIRED], 0.2f); break;
      case I_LOVE: tgt[S_HAPPY] = max(tgt[S_HAPPY], 0.35f); r = 255; g = 90; b = 170; break;
      case I_SHIVER: tgt[S_SAD] = max(tgt[S_SAD], 0.3f); tgt[S_SIZE_L] = tgt[S_SIZE_R] = 0.92f; r = 140; g = 200; b = 255; break;
      case I_BOUNCE: tgt[S_HAPPY] = max(tgt[S_HAPPY], 0.4f); break;
      default: break;
    }
  }
  // Duygular
  switch (emotion) {
    case E_HAPPY: tgt[S_HAPPY] = 0.5f; tgt[S_TIRED] = 0; tgt[S_SAD] = 0; break;
    case E_ANGRY: tgt[S_ANGRY] = 0.6f; tgt[S_TIRED] = 0.15f; tgt[S_SAD] = 0; r = 255; g = 60; b = 40; break;
    case E_SAD: tgt[S_SAD] = 0.6f; tgt[S_LOOKY] = 0.5f; r = 70; g = 130; b = 255; break;
    case E_SURPRISED: tgt[S_SIZE_L] = tgt[S_SIZE_R] = 1.2f; tgt[S_R] = 34; tgt[S_TIRED] = 0; tgt[S_HAPPY] = 0; tgt[S_BOTTOM] = 0; break;
    case E_SLEEPY: tgt[S_TIRED] = 0.62f; tgt[S_LOOKY] = 0.3f; break;
    case E_LOVE: tgt[S_HAPPY] = 0.35f; r = 255; g = 90; b = 170; break;
    case E_CONFUSED: tgt[S_SIZE_L] = 0.8f; tgt[S_SIZE_R] = 1.1f; break;
    default: break;
  }
  // Düşük pil: yorgun
  if (!onUSB && batPct >= 0 && batPct < 15) tgt[S_TIRED] = max(tgt[S_TIRED], batPct < 5 ? 0.6f : 0.35f);
  // Uyanış ritüeli (açılışta)
  uint32_t t = now - bootT;
  (void)t;
}

// ---------------- ALBÜM KAPAĞI ----------------
bool coverShouldShow(uint32_t now) {
  if (coverWant && coverUntil && (int32_t)(now - coverUntil) >= 0) coverWant = false;
  if (!coverWant) return false;
  if (isAsleep) return false;                                    // gece uykusunda gözler kapalı kalır
  if (notifText.active && !reached(now, notifText.until)) return false;   // bildirim gelince gözler döner
  if (pomoState || emotion != E_NONE) return false;
  return true;
}

void drawInfoLine(TextLine &t, int ty, uint16_t color, float dt) {
  if (!t.active) return;
  spr.setTextSize(1);
  spr.setTextColor(color);
  spr.setTextDatum(lgfx::textdatum_t::middle_left);
  const int margin = 12, avail = 240 - margin * 2;
  if (t.width <= avail) { spr.drawString(t.buf, 120 - t.width / 2, ty); return; }
  t.x += 38.0f * dt;                               // uzun ad kayar
  int gap = 50, period = t.width + gap;
  if (t.x > period) t.x -= period;
  int x = margin - (int)t.x;
  spr.setClipRect(margin, ty - 12, avail, 24);
  spr.drawString(t.buf, x, ty);
  spr.drawString(t.buf, x + period, ty);
  spr.clearClipRect();
}

// Kapak ekranı. k: 0 = ince çizgi, 1 = tam açık kapak.
// Kapak tampona BİR KEZ açılır; animasyon ekrana sadece ortadan büyüyen bir şeridini basar (perde gibi).
void renderCover(uint32_t now, float dt, float k, uint16_t lineCol) {
  const int cyC = COVER_Y + COVER_SZ / 2, infoY = COVER_Y + COVER_SZ + 2;
  if (coverOnTop) {                                // tam ekrandan normale geçildi: durum çubuğunun yerini temizle
    lcd.fillRect(0, 0, 240, STATUS_H, BG); coverOnTop = false; statusDirty = true;
  }
  if (!coverInSpr || coverDirty || coverPrepFull) {
    coverPrepFull = false;
    uint32_t t0 = millis();
    spr.fillScreen(BG);
    bool ok = coverJpg && spr.drawJpg(coverJpg, coverLen, COVER_X, COVER_Y, COVER_SZ, COVER_SZ);
    if (!ok) {                                     // kapak yoksa/açılamadıysa: nota işaretli kutu
      spr.fillRoundRect(COVER_X, COVER_Y, COVER_SZ, COVER_SZ, 12, rgb(36, 38, 48));
      spr.setTextColor(lineCol);
      spr.setTextDatum(lgfx::textdatum_t::middle_center);
      spr.drawString("\xE2\x99\xAA", 120, cyC);   // ♪
    }
    if (coverJpg) Serial.printf("Kapak cizildi: %s, %u ms\n", ok ? "tamam" : "HATA", (unsigned)(millis() - t0));
    coverInSpr = true; coverDirty = false;
  }
  // Alt bilgi (kapak alanına dokunmaz)
  spr.fillRect(0, infoY, 240, SPR_H - infoY, BG);
  drawInfoLine(coverTitle, infoY + 12, rgb(242, 242, 247), dt);
  drawInfoLine(coverArtist, infoY + 34, rgb(160, 165, 182), dt);
  uint32_t pos = progPos + (progPlaying ? now - progAt : 0);
  if (progDur && pos > progDur) pos = progDur;
  float f = progDur ? pos / (float)progDur : 0;
  const int by = SPR_H - 14;                       // kasanın kenarına girmesin
  spr.fillRoundRect(20, by, 200, 4, 2, rgb(58, 60, 70));
  spr.fillRoundRect(20, by, max(4, (int)(200 * f)), 4, 2, rgb(30, 215, 96));
  if (!progPlaying && progDur) {                   // durdu: küçük duraklat işareti
    spr.fillRect(224, by - 3, 3, 10, rgb(200, 200, 210));
    spr.fillRect(230, by - 3, 3, 10, rgb(200, 200, 210));
  }

  lcd.startWrite();
  if (k >= 1) {
    spr.pushSprite(0, STATUS_H);
  } else {
    float e = 1 - (1 - k) * (1 - k) * (1 - k);   // hızlı başla, yumuşak dur
    int hh = (int)(COVER_SZ * e);
    int top = cyC - hh / 2;
    lcd.fillRect(0, STATUS_H, 240, max(0, top), BG);
    lcd.fillRect(0, STATUS_H + top + hh, 240, SPR_H - (top + hh), BG);
    if (hh < 4) {
      lcd.fillRect(0, STATUS_H + top, 240, hh, BG);
      lcd.fillRoundRect(46, STATUS_H + cyC - 2, 148, 4, 2, lineCol);
    } else {
      lcd.setClipRect(0, STATUS_H + top, 240, hh);
      spr.pushSprite(0, STATUS_H);
      lcd.clearClipRect();
      lcd.fillRect(COVER_X - 2, STATUS_H + top, 2, hh, lineCol);            // şeridin kenarlarında ince parlak çizgi
      lcd.fillRect(COVER_X + COVER_SZ, STATUS_H + top, 2, hh, lineCol);
    }
  }
  lcd.endWrite();
}

// JPEG'in genişlik/yüksekliğini başlığından oku (SOF işaretçisi)
bool jpgSize(const uint8_t *d, uint32_t n, int &w, int &h) {
  uint32_t i = 2;
  while (i + 9 < n) {
    if (d[i] != 0xFF) { i++; continue; }
    uint8_t m = d[i + 1];
    if (m == 0xFF) { i++; continue; }
    if (m == 0x01 || (m >= 0xD0 && m <= 0xD8)) { i += 2; continue; }
    uint32_t L = ((uint32_t)d[i + 2] << 8) | d[i + 3];
    if (m >= 0xC0 && m <= 0xCF && m != 0xC4 && m != 0xC8 && m != 0xCC) {
      h = (d[i + 5] << 8) | d[i + 6]; w = (d[i + 7] << 8) | d[i + 8];
      return w > 0 && h > 0;
    }
    i += 2 + L;
  }
  return false;
}

// Kapağı bir tampona yerleştir. (dx, dy): resmin sol üstünün tampondaki yeri (eksi olabilir)
bool jpgInto(LGFX_Sprite &s, int dx, int dy, int sw, int sh) {
  int x = dx, y = dy, offX = 0, offY = 0;
  if (x < 0) { offX = -x; x = 0; }
  if (y < 0) { offY = -y; y = 0; }
  if (x >= sw || y >= sh) return true;
  return s.drawJpg(coverJpg, coverLen, x, y, sw - x, sh - y, offX, offY);
}

// Tam ekran kapağı tamponlara BİR KEZ aç: alt 216 satır ana tampona, üst 24 satır küçük tampona
void prepCoverFull(uint16_t lineCol) {
  uint32_t t0 = millis();
  int w = 0, h = 0;
  bool have = coverJpg && jpgSize(coverJpg, coverLen, w, h);
  int ox = have ? (240 - w) / 2 : 0, oy = have ? (240 - h) / 2 : 0;   // 240'tan küçük gelirse ortala
  if (!sprTopOk) {
    sprTop.setColorDepth(spr.getColorDepth());
    sprTopOk = sprTop.createSprite(240, STATUS_H) != nullptr;
    if (!sprTopOk) Serial.println("Ust serit icin RAM yok, ust 24 satir dogrudan cizilecek");
  }
  spr.fillScreen(BG);
  bool ok = have && jpgInto(spr, ox, oy - STATUS_H, SPR_W, SPR_H);
  if (sprTopOk) { sprTop.fillScreen(BG); if (have) jpgInto(sprTop, ox, oy, 240, STATUS_H); }
  if (!ok) {                                       // kapak yok / açılamadı: ortada nota işaretli kutu
    spr.fillRoundRect(45, 120 - STATUS_H - 75, 150, 150, 12, rgb(36, 38, 48));
    spr.setTextColor(lineCol);
    spr.setTextDatum(lgfx::textdatum_t::middle_center);
    spr.drawString("\xE2\x99\xAA", 120, 120 - STATUS_H);
  }
  if (coverJpg) Serial.printf("Tam ekran kapak: %dx%d %s, %u ms\n", w, h, ok ? "tamam" : "HATA", (unsigned)(millis() - t0));
}

// Tam ekran kapak. k: 0 = ortada ince çizgi, 1 = tam açık. Perde ortadan yukarı-aşağı açılır.
void renderCoverFull(uint32_t now, float k, uint16_t lineCol) {
  if (!coverInSpr || coverDirty || !coverPrepFull) {
    prepCoverFull(lineCol);
    coverInSpr = true; coverDirty = false; coverPrepFull = true; coverFullDrawn = false;
  }
  if (k >= 1 && coverFullDrawn) return;            // durağan: hiçbir şey çizme
  float e = k >= 1 ? 1 : 1 - (1 - k) * (1 - k) * (1 - k);
  int hh = (int)(240 * e);
  int top = 120 - hh / 2, bot = top + hh;
  lcd.startWrite();
  if (top > 0) lcd.fillRect(0, 0, 240, top, BG);
  if (bot < 240) lcd.fillRect(0, bot, 240, 240 - bot, BG);
  if (hh < 4) {
    lcd.fillRect(0, top, 240, hh, BG);
    lcd.fillRoundRect(2, 118, 236, 4, 2, lineCol);
  } else {
    int t1 = top > STATUS_H ? top : STATUS_H;      // ekranın 24-240 arası: ana tampon
    if (bot > t1) { lcd.setClipRect(0, t1, 240, bot - t1); spr.pushSprite(0, STATUS_H); lcd.clearClipRect(); }
    if (top < STATUS_H) {                          // en üst 24 satır: küçük tampon
      int b0 = bot < STATUS_H ? bot : STATUS_H;
      if (sprTopOk) { lcd.setClipRect(0, top, 240, b0 - top); sprTop.pushSprite(0, 0); lcd.clearClipRect(); }
      else if (k >= 1 && coverJpg) {               // RAM yetmediyse: en sonda bir kez doğrudan çiz
        int w = 0, h = 0;
        if (jpgSize(coverJpg, coverLen, w, h)) {
          lcd.setClipRect(0, 0, 240, STATUS_H);
          lcd.drawJpg(coverJpg, coverLen, (240 - w) / 2, (240 - h) / 2);
          lcd.clearClipRect();
        }
      }
    }
    if (k < 1) {                                   // perdenin kenarlarında ince parlak çizgi
      lcd.fillRect(0, top, 240, 2, lineCol);
      lcd.fillRect(0, bot - 2, 240, 2, lineCol);
    }
  }
  lcd.endWrite();
  coverOnTop = true;
  if (k >= 1) coverFullDrawn = true;
}

// ---------------- KARE ----------------
void renderFrame(uint32_t now, float dt) {
  const ModePreset &M = P(mode);
  // Kapak geçişi: 0-0.45 gözler kapanıp ortada çizgi olur, 0.45-1 çizgi kapağa açılır
  {
    float target = coverShouldShow(now) ? 1.0f : 0.0f;
    if (coverT != target) {                        // kapak tampona bir kez açılır; her karede yeniden açmak animasyonu takıltıyordu
      float step = dt / 0.8f;
      coverT = target > coverT ? min(target, coverT + step) : max(target, coverT - step);
    }
    if (coverT >= 0.45f) {
      float k = (coverT - 0.45f) / 0.55f;
      if (coverFull) renderCoverFull(now, k, rgb(colR, colG, colB));
      else renderCover(now, dt, k, rgb(colR, colG, colB));
      return;
    }
  }
  coverInSpr = false;                              // tampon göz çizimiyle dolacak
  coverFullDrawn = false;
  if (coverOnTop) {                                // tam ekran kapaktan gözlere dönüldü: durum çubuğu geri gelsin
    lcd.fillRect(0, 0, 240, STATUS_H, BG); coverOnTop = false; statusDirty = true;
  }
  float closeK = coverT / 0.45f;                   // 0 = normal göz, 1 = tamamen kapalı çizgi
  closeK = closeK * closeK * (3 - 2 * closeK);
  float tgt[S_COUNT]; uint8_t tr, tg, tb;
  composeTargets(now, tgt, tr, tg, tb);
  for (int i = 0; i < S_COUNT; i++) { sp[i].t = tgt[i]; sp[i].step(dt, 140); }

  // Gece uykusu: gözler yavaşça kapanır, uyanınca hızlıca açılır
  {
    float sk = isAsleep ? 1.0f : 0.0f;
    sleepK += (sk - sleepK) * (1 - expf(-dt / (isAsleep ? 0.9f : 0.25f)));
    if (fabsf(sk - sleepK) < 0.005f) sleepK = sk;
  }
  const float awakeK = 1 - sleepK;

  // Uyanış ritüelinde etrafa bakınma
  uint32_t tb0 = now - bootT;
  if (tb0 > 1500 && tb0 < 2400) { lookTgtX = tb0 < 1950 ? -0.6f : 0.6f; lookTgtY = 0; nextLook = now + 900; }

  lookX.t = lookTgtX; lookYs.t = lookTgtY + sp[S_LOOKY].x;
  float kLook = (mode == 2) ? 420 : 260;
  lookX.step(dt, kLook); lookYs.step(dt, kLook);

  bool hasText = (notifText.active && !reached(now, notifText.until)) || (songText.active && mode != MODE_CLOCK && !pomoState);
  offsetY.t = hasText ? -12 : 0; offsetY.step(dt, 120);

  float ca = 1 - expf(-dt * 6);                    // renk geçişi
  colR = lerpf(colR, tr, ca); colG = lerpf(colG, tg, ca); colB = lerpf(colB, tb, ca);
  uint16_t col = rgb(colR, colG, colB);

  // Ritim / sallanma
  float bob = 0;
  if (mode == 5) {
    float ph = fmodf((float)(int32_t)(now - beatRef), beatPeriod);
    if (ph < 0) ph += beatPeriod;
    float p = ph / beatPeriod;
    bob = M.bobAmp * (1 - p) * (1 - p);            // vuruşta aşağı, yavaşça geri
    int32_t idx = (int32_t)floorf((int32_t)(now - beatRef) / beatPeriod);
    if (idx != lastBeatIdx) {
      lastBeatIdx = idx;
      lookX.t = (idx & 1) ? 0.3f : -0.3f;          // her vuruşta yana sallan
      lookTgtX = lookX.t;
      if (idx % 2 == 0 && !isAsleep) spawn(P_NOTE, frand(50, 190), 70, frand(-15, 15), -35, 1.6f, tr, tg, tb);
    }
  } else if (M.bobAmp > 0) {
    bob = M.bobAmp * sinf(now * 2 * PI / 700.0f);
  }
  if (idle == I_BOUNCE) bob -= 9.0f * fabsf(sinf((now - idleStart) * PI / 430.0f));     // üç kez zıplar
  bob *= awakeK;

  // Nefes efekti
  float breathPeriod = (mode == 1) ? 5000 : 3500;
  float breath = 1.0f + ((mode == 1) ? 0.04f : 0.025f) * sinf(now * 2 * PI / breathPeriod);

  // Gözyaşı
  float w = sp[S_W].x, h = sp[S_H].x * breath, gap = sp[S_GAP].x;
  float cy = 100 + lookYs.x * 18 + bob + offsetY.x;
  if (closeK > 0) {                                // kapağa geçerken gözler ortada birleşir
    if (coverFull) { w = lerpf(w, 116, closeK); gap = lerpf(gap, 4, closeK); cy = lerpf(cy, 120 - STATUS_H, closeK); }   // ekranın tam ortası, boydan boya
    else { w = lerpf(w, 72, closeK); gap = lerpf(gap, 4, closeK); cy = lerpf(cy, COVER_Y + COVER_SZ / 2, closeK); }
  }
  float lookOfs = lookX.x * 24 * (1 - closeK) * awakeK;
  float lxC = 120 - (gap / 2 + w / 2) + lookOfs;
  float rxC = 120 + (gap / 2 + w / 2) + lookOfs;
  if (pendingTear) { pendingTear = false; if (mode == 3) spawn(P_TEAR, lxC - w / 2 + 12, cy + h * 0.35f, 0, 10, 1.6f, 120, 190, 255); }
  if (emotion == E_LOVE && random(100) < 6) spawn(P_HEART, frand(40, 200), frand(130, 170), frand(-10, 10), -40, 1.4f, 255, 90, 170);

  // Merak: yana bakarken dıştaki göz büyür
  float curL = 1, curR = 1;
  if (lookX.x > 0.4f) { curR = 1 + 0.18f * (lookX.x - 0.4f) / 0.6f; curL = 1 - 0.05f * (lookX.x - 0.4f) / 0.6f; }
  if (lookX.x < -0.4f) { curL = 1 + 0.18f * (-lookX.x - 0.4f) / 0.6f; curR = 1 - 0.05f * (-lookX.x - 0.4f) / 0.6f; }
  float sL = sp[S_SIZE_L].x * curL, sR = sp[S_SIZE_R].x * curR;

  float openL = blinkOpen(now, 0), openR = blinkOpen(now, 1);
  float wake = clampf((float)(int32_t)(now - bootT - 300) / 1000.0f, 0, 1);   // uyanış: yavaşça açılır
  wake = wake * wake * (3 - 2 * wake);
  openL *= wake; openR *= wake;
  if (closeK > 0) { openL *= 1 - closeK; openR *= 1 - closeK; }
  openL *= awakeK; openR *= awakeK;
  finishBlinkIfDone(now);

  updateParticles(dt);

  spr.fillScreen(BG);
  if (mode == 5) drawHeadphones(bob, col);
  drawEye(lxC, cy, w * sL, h * sL, sp[S_R].x, openL, true, col,
          sp[S_TIRED].x, sp[S_ANGRY].x, sp[S_SAD].x, sp[S_HAPPY].x, sp[S_BOTTOM].x);
  drawEye(rxC, cy, w * sR, h * sR, sp[S_R].x, openR, false, col,
          sp[S_TIRED].x, sp[S_ANGRY].x, sp[S_SAD].x, sp[S_HAPPY].x, sp[S_BOTTOM].x);
  drawParticles();
  if (closeK < 0.05f) drawBottomText(now, dt, col);

  lcd.startWrite();
  spr.pushSprite(0, STATUS_H);
  lcd.endWrite();
}

bool somethingMoving(uint32_t now) {
  if (sleepK > 0 && sleepK < 1) return true;     // uykuya dalış / uyanış animasyonu
  if (blink.active || mode == 5 || P(mode).bobAmp > 0 || idle != I_NONE) return true;
  if (coverT > 0 && coverT < 1) return true;
  if (coverT < 1 && coverShouldShow(now)) return true;
  if (lookX.moving() || lookYs.moving() || offsetY.moving()) return true;
  for (int i = 0; i < S_COUNT; i++) if (sp[i].moving()) return true;
  for (auto &p : parts) if (p.on) return true;
  if (songText.active && songText.width > 220) return true;
  if (notifText.active && notifText.width > 220) return true;
  if (now - bootT < 2600) return true;
  return false;
}

// ---------------- SERİ PORT / BOOT TUŞU ----------------
void handleSerial() {
  while (Serial.available()) {
    char c = Serial.read();
    if (c >= '0' && c <= '7') setMode(c - '0', true);
    else if (c == 'o') { if (pomoState) stopPomodoro(); else startPomodoro(1, 1); }
    else if (c == 's') { timeLocal = 12 * 3600 + 34 * 60; timeSyncMs = millis(); timeValid = true; weatherValid = true; weatherTemp = 18; weatherCode = 2; setMode(MODE_CLOCK, true); }
    else if (c == 'r') setRotation(rotationIdx + 1);
    else if (c == 'k') {
      coverWant = !coverWant; coverUntil = 0;
      const char *ti = "Test Sarki (feat. Uzun Isimli Sanatci)", *ar = "Sanatci";
      setText(coverTitle, (const uint8_t *)ti, strlen(ti), 0); setText(coverArtist, (const uint8_t *)ar, strlen(ar), 0);
      progPos = 60000; progDur = 200000; progAt = millis(); progPlaying = true;
    }
    else if (c == 'i') { static int n = 0; n = n % (I_COUNT - 1) + 1; startIdle((Idle)n, millis()); Serial.printf("Hareket: %d\n", n); }
    else if (c == 'c') { clockOn = !clockOn; if (!clockOn && mode == MODE_CLOCK) setMode(prevModeBeforeClock != MODE_CLOCK ? prevModeBeforeClock : 0, false); saveLater(); Serial.printf("Saat modu %s\n", clockOn ? "acik" : "kapali"); }
    else if (c == 'e') { static int e = 0; e = e % (E_COUNT - 1) + 1; setEmotion(e, 3000); }
    else if (c == 't') { const char *s = "Test şarkı - Uzun bir şarkı adı kayarak gösteriliyor ♪"; setText(songText, (const uint8_t *)s, strlen(s), 0); }
    else if (c == 'n') { const char *s = "Ayşe: Naber, nasılsın?"; setText(notifText, (const uint8_t *)s, strlen(s), 4000); setEmotion(E_SURPRISED, 1200); }
    else if (c == 'p') { setMusicPlaying(!musicPlaying); Serial.printf("Muzik: %s\n", musicPlaying ? "caliyor" : "durdu"); }
    else if (c == 'b') { beatPeriod = (beatPeriod > 480 && beatPeriod < 520) ? 60000.0f / 90 : 500; beatRef = millis(); Serial.printf("Ritim: %.0f BPM\n", 60000.0f / beatPeriod); }
    else if (c == 'l') { brightness = brightness > 200 ? 30 : (brightness < 60 ? 120 : 255); noteActivity(); Serial.printf("Parlaklik: %u\n", brightness); }
    else if (c == 'd') { lastActivity = millis() - (uint32_t)(dimAfterS ? dimAfterS : 60) * 1000UL - 1000; if (!dimAfterS) dimAfterS = 60; Serial.println("Kararma testi (dokununca aydinlanir)"); }
    else if (c == 'g') { forceNight = forceNight == 1 ? 0 : 1; wakeUntil = 0; Serial.printf("Gece uykusu testi: %s\n", forceNight == 1 ? "acik" : "kapali"); }
  }
}

void handleButton(uint32_t now) {
  static bool last = true; static uint32_t downT = 0; static bool longDone = false, pressWoke = false;
  bool b = digitalRead(PIN_BOOT);
  if (last && !b) {                               // basıldı
    downT = now; longDone = false;
    pressWoke = isDimmed || isAsleep;             // kararmış / uyuyorsa: bu basış sadece uyandırır
    noteActivity();
    if (nightNow(now)) wakeUntil = now + 20000;   // gece: her basışta 20 sn daha uyanık kal
  }
  if (!b && !longDone && now - downT > 1200) { longDone = true; noteActivity(); setRotation(rotationIdx + 1); }
  if (!last && b && !longDone && now - downT > 30) {
    if (pressWoke) {}
    else if (coverT > 0 || coverWant) { coverWant = false; coverUserHide = true; }   // kapak açıksa: sadece kapağı kapat
    else {
      int nm = (mode + 1) % MODE_COUNT;
      if (nm == MODE_CLOCK && !clockOn) nm = (nm + 1) % MODE_COUNT;   // kapalı saat modunu atla
      setMode(nm, true);
    }
  }
  last = b;
}

// ---------------- SETUP / LOOP ----------------
void setup() {
  Serial.begin(115200);
  pinMode(PIN_BOOT, INPUT_PULLUP);
#if HAS_BATTERY_DIVIDER
  analogSetPinAttenuation(PIN_BAT, ADC_11db);
#endif
  prefs.begin("goz", false);
  { uint8_t cp[12]; if (prefs.getBytes("custom", cp, 12) == 12) applyCustom(cp); }
  mode = prefs.getUChar("mode", 0); if (mode >= MODE_COUNT) mode = 0;
  rotationIdx = prefs.getUChar("rot", 0) & 3;
  clockOn = prefs.getBool("clkOn", true);
  livelyLvl = prefs.getUChar("liv", 2); if (livelyLvl > 3) livelyLvl = 2;
  if (mode == MODE_CLOCK && !clockOn) mode = 0;
  brightness = prefs.getUChar("bri", 200); if (brightness < 4) brightness = 4;
  dimAfterS = prefs.getUShort("dimS", 60);
  dimPct = prefs.getUChar("dimP", 25);
  nightOn = prefs.getBool("ntOn", false);
  nightFrom = prefs.getUChar("ntF", 23) % 24;
  nightTo = prefs.getUChar("ntT", 7) % 24;
  nightLvl = prefs.getUChar("ntL", 6);

  blInit();                                      // ışık kapalı başlar, ekran temizlenince yavaşça açılır
  lcd.init();
  lcd.setRotation(rotationIdx);
  lcd.fillScreen(BG);

  // Çizim tamponu: önce 16 bit dene, RAM yetmezse 8 bit
  spr.setColorDepth(16);
  if (!spr.createSprite(SPR_W, SPR_H)) {
    spr.setColorDepth(8);
    if (!spr.createSprite(SPR_W, SPR_H)) {
      lcd.setTextColor(lcd.color565(255, 60, 60));
      lcd.drawString("RAM yetmedi", 20, 110);
      blWriteDuty(blDuty(160));
      Serial.println("Sprite olusturulamadi");
      while (true) delay(1000);
    }
    Serial.println("Uyari: 8 bit renk modunda calisiyor");
  }

  spr.loadFont(FONT_TR);                         // Türkçe yazı tipi

  cmdQ = xQueueCreate(16, sizeof(Cmd));

  // Başlangıç değerleri
  const ModePreset &M = P(mode);
  for (int i = 0; i < S_COUNT; i++) { sp[i].x = sp[i].t = M.shape[i]; }
  colR = M.r; colG = M.g; colB = M.b;
  bootT = millis();
  lastActivity = bootT; blLastMs = bootT;
  blink.next = bootT + 2600;
  nextIdle = bootT + 9000;
  beatRef = bootT;

  readBattery(bootT);
  setupBLE();
  Serial.printf("Bos heap: %u, en buyuk blok: %u\n", ESP.getFreeHeap(), heap_caps_get_largest_free_block(MALLOC_CAP_8BIT));
  Serial.printf("Yazilim surumu: %d\n", FW_VERSION);
  Serial.println("Hazir. 0-7 mod | r yon | k kapak | e duygu | t yazi | n bildirim | p muzik | b ritim | o pomodoro(1dk) | s saat | l isik | d kararma | g gece | i hareket | c saat ac/kapa");
}

void loop() {
  static uint32_t lastFrame = 0;
  uint32_t now = millis();

  Cmd c;
  while (xQueueReceive(cmdQ, &c, 0) == pdTRUE) handleCmd(c);
  blUpdate(millis());
  if (otaActive) {                                // güncelleme sırasında sadece veri al
    if (millis() - otaLastRx > 8000 || !bleConnected) {   // yarıda kaldı: iptal et, normale dön
      Update.abort(); otaActive = false; otaSize = 0;
      otaNotify(0);
      lcd.fillScreen(BG); statusDirty = true;
      Serial.println("Guncelleme yarida kaldi, iptal edildi");
    } else { delay(1); return; }
  }
  handleSerial();
  handleButton(now);

  if (reached(now, nextBat)) { readBattery(now); nextBat = now + 2000; }
  updateStatusChar(now);
  if (statusDirty && !coverOnTop) drawStatusBar();   // tam ekran kapak açıkken durum çubuğu gizli

  updatePower(now);
  flushSettings(now);
  updatePhoneLost(now);
  updateBehavior(now);
  updatePomodoro(now);
  updateAutoRock(now);

  // Hareket varken ~60 fps, sakinken 20 fps, kararmışken en fazla 30, uyurken 10 fps (pil tasarrufu)
  uint32_t interval = somethingMoving(now) ? 16 : 50;
  if (isDimmed && interval < 33) interval = 33;
  if (isAsleep && sleepK >= 1) interval = 100;
  if (coverFullDrawn && coverT >= 1) interval = 100;   // durağan tam ekran kapak
  if (now - lastFrame >= interval) {
    float dt = clampf((now - lastFrame) / 1000.0f, 0.001f, 0.05f);
    lastFrame = now;
    renderFrame(now, dt);
  } else {
    delay(1);                                    // Bluetooth görevine zaman bırak
  }
}
